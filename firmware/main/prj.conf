## CMakeLists.txt
```
# wallckr-z2 vehicle firmware.
#   west build -b nucleo_f401re --shield motherboard_shield \
#     --shield x_nucleo_bnrg2a1 --shield buttonled_shield firmware/main

cmake_minimum_required(VERSION 3.20.0)

find_package(Zephyr REQUIRED HINTS $ENV{ZEPHYR_BASE})
project(wallckr_main LANGUAGES CXX)

add_subdirectory(../lib wallckr_lib)
target_link_libraries(app PRIVATE wallckr_lib)

target_sources(app PRIVATE
    src/main.cpp
    src/ZephyrAnalogSensors.cpp
    src/ZephyrMotorController.cpp
    src/ZephyrNusStream.cpp
    src/ZephyrRobotIndicators.cpp
    src/ZephyrSteeringServo.cpp
    src/ZephyrUltrasonicSensor.cpp
)

# The minimal C++ library has no STL headers; ETL must not reach for them.
target_compile_definitions(app PRIVATE ETL_NO_STL)
```

## prj.conf
```kconfig
# Language: C++23 on the minimal C++ library, no exceptions/RTTI.
CONFIG_CPP=y
CONFIG_STD_CPP23=y
CONFIG_MINIMAL_LIBCPP=y
CONFIG_CPP_EXCEPTIONS=n
CONFIG_CPP_RTTI=n
# Containers/utilities in place of the STL the minimal library lacks.
CONFIG_ETL=y

# Log output on the ST-LINK virtual COM port.
CONFIG_LOG=y

# Peripherals behind the IMotorController, ISteeringServo, IDistanceSensor,
# IBatterySensor, ICurrentSensor and IRobotIndicators adapters.
CONFIG_GPIO=y
CONFIG_PWM=y
CONFIG_ADC=y

# The battery / current channels are read raw and scaled by the adapters
# (lib/ expects mV at the ADC pin); the upstream drivers are not needed.
CONFIG_VOLTAGE_DIVIDER=n
CONFIG_CURRENT_AMP=n

# ovladacka commands and telemetry over the Nordic UART Service.
CONFIG_BT=y
CONFIG_BT_PERIPHERAL=y
CONFIG_BT_ZEPHYR_NUS=y
CONFIG_BT_DEVICE_NAME="wallckr"
# Let the phone negotiate a 247-byte ATT MTU, so a tick's telemetry fits one
# notification (see ZephyrNusStream).
CONFIG_BT_L2CAP_TX_MTU=247
CONFIG_BT_BUF_ACL_RX_SIZE=251
CONFIG_BT_BUF_ACL_TX_SIZE=251

# Control thread: main() waits on the tick timer and NUS command events.
CONFIG_EVENTS=y
# main() holds the robot objects (~1.1 KB frame) and calls down into the
# sensor, ADC and Bluetooth drivers.
CONFIG_MAIN_STACK_SIZE=4096
```

## src/main.cpp
```c
#include "AutoSteering.h"
#include "Battery.h"
#include "ExpFilter.h"
#include "ExternalCommandDecoder.h"
#include "Motion.h"
#include "OvladackaParser.h"
#include "Regulator.h"
#include "Robot.h"
#include "RobotPrinter.h"
#include "Sensing.h"
#include "ZephyrAnalogSensors.h"
#include "ZephyrMotorController.h"
#include "ZephyrNusStream.h"
#include "ZephyrRobotIndicators.h"
#include "ZephyrSteeringServo.h"
#include "ZephyrUltrasonicSensor.h"

#include <zephyr/app_version.h>
#include <zephyr/kernel.h>
#include <zephyr/logging/log.h>

LOG_MODULE_REGISTER(wallckr, LOG_LEVEL_INF);

namespace {

// Events the control thread waits on.
constexpr uint32_t TICK_EVENT = BIT(0);
constexpr uint32_t COMMAND_EVENT = BIT(1);

// Automatic action every tick, status check every 10th tick (v1's 100 ms
// and 1000 ms).
constexpr k_timeout_t TICK_PERIOD = K_MSEC(100);
constexpr uint32_t STATUS_CHECK_TICKS = 10;

// v1's NewPing maximum; a timeout reads as this distance.
constexpr unsigned int MAX_DISTANCE_CM = 200;

// Battery thresholds in mV at the ADC pin, behind the 1/5 divider.
constexpr int BATTERY_CELL_COUNT = 8;
constexpr int BATTERY_VOLTAGE_DIVIDER_FACTOR = 5;
constexpr uint16_t BATTERY_CELL_CUTOFF_mVDC = 900;
constexpr uint16_t BATTERY_PACK_CUTOFF_mVDC
    = BATTERY_CELL_CUTOFF_mVDC * BATTERY_CELL_COUNT / BATTERY_VOLTAGE_DIVIDER_FACTOR;
// v1's 50 mV behind its 1/16 divider: 800 mV at the pack.
constexpr uint16_t BATTERY_HYSTERESIS_mVDC = 160;

// Wall-following steering, as in v1.
constexpr int FILTER_N = 4;
constexpr int K_GAIN = 5;
constexpr int RIGHT_DISTANCE_SETPOINT_CM = 25;
constexpr int INSENSITIV_CM = 2;
constexpr int REGULATOR_ACTION_LIMIT_UP = 45;
constexpr int REGULATOR_ACTION_LIMIT_BOTTOM = -30;

#define MOTOR_NODE DT_NODELABEL(motor)
#define SERVO_NODE DT_NODELABEL(steering_servo)
#define CURRENT_NODE DT_NODELABEL(supply_current)

k_event control_events;
k_timer tick_timer;

void on_tick(k_timer*)
{
    k_event_post(&control_events, TICK_EVENT);
}

bool init_ok(int ret, const char* what)
{
    if (ret) {
        LOG_ERR("%s init failed: %d", what, ret);
    }
    return ret == 0;
}

} // namespace

// The main thread is the control thread: it owns the robot, and nothing else
// calls into it. The objects live on its stack, as in v1's loop(); main()
// never returns once they exist.
int main()
{
    LOG_INF("wallckr-z2 %s", APP_VERSION_EXTENDED_STRING);

    k_event_init(&control_events);
    k_timer_init(&tick_timer, on_tick, nullptr);

    // Front = J4 (Sensor 3), right front = J3 (Sensor 2), right = J2
    // (Sensor 1, v1's right center).
    ZephyrUltrasonicSensor sonar_front(GPIO_DT_SPEC_GET(DT_NODELABEL(ultrasonic3), trigger_gpios),
        GPIO_DT_SPEC_GET(DT_NODELABEL(ultrasonic3), echo_gpios), MAX_DISTANCE_CM);
    ZephyrUltrasonicSensor sonar_right_front(GPIO_DT_SPEC_GET(DT_NODELABEL(ultrasonic2), trigger_gpios),
        GPIO_DT_SPEC_GET(DT_NODELABEL(ultrasonic2), echo_gpios), MAX_DISTANCE_CM);
    ZephyrUltrasonicSensor sonar_right_center(GPIO_DT_SPEC_GET(DT_NODELABEL(ultrasonic1), trigger_gpios),
        GPIO_DT_SPEC_GET(DT_NODELABEL(ultrasonic1), echo_gpios), MAX_DISTANCE_CM);
    ZephyrBatterySensor battery_sensor(ADC_DT_SPEC_GET(DT_NODELABEL(battery_voltage)));
    ZephyrCurrentSensor current_sensor(ADC_DT_SPEC_GET(CURRENT_NODE),
        DT_PROP(CURRENT_NODE, sense_resistor_milli_ohms), DT_PROP(CURRENT_NODE, sense_gain_mult),
        DT_PROP(CURRENT_NODE, sense_gain_div));
    ZephyrMotorController motor_controller(PWM_DT_SPEC_GET(MOTOR_NODE), GPIO_DT_SPEC_GET(MOTOR_NODE, ph_gpios));
    ZephyrSteeringServo steering_servo(
        PWM_DT_SPEC_GET(SERVO_NODE), DT_PROP(SERVO_NODE, min_pulse), DT_PROP(SERVO_NODE, max_pulse));
    ZephyrRobotIndicators robot_indicators(GPIO_DT_SPEC_GET(DT_NODELABEL(led_state1), gpios),
        GPIO_DT_SPEC_GET(DT_NODELABEL(led_state2), gpios), GPIO_DT_SPEC_GET(DT_NODELABEL(led_err), gpios));
    ZephyrNusStream nus_stream(control_events, COMMAND_EVENT);

    // The motor first, so it is stopped as early as possible.
    if (!init_ok(motor_controller.init(), "motor") || !init_ok(steering_servo.init(), "servo")
        || !init_ok(sonar_front.init(), "front sensor") || !init_ok(sonar_right_front.init(), "right front sensor")
        || !init_ok(sonar_right_center.init(), "right sensor") || !init_ok(battery_sensor.init(), "battery sensor")
        || !init_ok(current_sensor.init(), "current sensor") || !init_ok(robot_indicators.init(), "LEDs")
        || !init_ok(nus_stream.init(), "Bluetooth")) {
        // Don't run the robot, but keep the objects alive: callbacks already
        // registered (echo interrupts, Bluetooth) still point at them.
        k_sleep(K_FOREVER);
    }

    RobotPrinter ble_out(nus_stream);
    DistanceSensors distance_sensors
        = { .front = sonar_front, .right_front = sonar_right_front, .right_center = sonar_right_center };
    Sensing robot_sensing(distance_sensors, ble_out);
    Battery robot_battery(
        battery_sensor, current_sensor, ble_out, BATTERY_PACK_CUTOFF_mVDC, BATTERY_HYSTERESIS_mVDC);
    Motion robot_motion(motor_controller, steering_servo);
    OvladackaParser ovladacka_parser;
    ExternalCommandDecoder external_command_decoder(nus_stream, ovladacka_parser);
    ExpFilter<int, FILTER_N> servo_cmd_filter;
    Regulator_P<int> side_distance_regulator(K_GAIN, RIGHT_DISTANCE_SETPOINT_CM, INSENSITIV_CM,
        REGULATOR_ACTION_LIMIT_UP, REGULATOR_ACTION_LIMIT_BOTTOM);
    AutoSteering<int> wall_following_steering(RIGHT_DISTANCE_SETPOINT_CM, side_distance_regulator, servo_cmd_filter);
    Robot robot(robot_sensing, robot_battery, robot_motion, wall_following_steering, external_command_decoder,
        robot_indicators);

    // First tick right away, so the first status check runs at boot as in v1.
    k_timer_start(&tick_timer, K_NO_WAIT, TICK_PERIOD);

    for (uint32_t tick = 0;;) {
        // Clears the events it returns atomically, so none posted meanwhile
        // is lost.
        uint32_t events = k_event_wait_safe(&control_events, TICK_EVENT | COMMAND_EVENT, false, K_FOREVER);

        // The parser takes at most 10 bytes per call; drain them all now
        // rather than leaving the rest for the next tick. This always ends:
        // bytes only arrive from the Bluetooth RX thread, which has a lower
        // priority than this one (CONFIG_BT_RX_PRIO > CONFIG_MAIN_THREAD_PRIORITY)
        // and so can't add any while the loop runs.
        while (nus_stream.available() > 0) {
            robot.check_external_command();
        }

        if (events & TICK_EVENT) {
            uint32_t now_ms = k_uptime_get_32();
            if (tick % STATUS_CHECK_TICKS == 0) {
                robot.perform_status_check(now_ms);
            }
            robot.perform_automatic_action(now_ms);
            tick++;
        }

        robot.apply_motion_command();
        nus_stream.flush();
    }
}
```

## src/ZephyrAnalogSensors.cpp
```c
#include "ZephyrAnalogSensors.h"

#include <zephyr/logging/log.h>

LOG_MODULE_DECLARE(wallckr);

namespace {

int setup(const adc_dt_spec& channel)
{
    if (!adc_is_ready_dt(&channel)) {
        return -ENODEV;
    }
    return adc_channel_setup_dt(&channel);
}

// One conversion; raw and pin_mv are left untouched on failure.
int read(const adc_dt_spec& channel, int32_t& raw, int32_t& pin_mv)
{
    int16_t sample = 0;
    adc_sequence sequence = {
        .buffer = &sample,
        .buffer_size = sizeof(sample),
    };

    if (int ret = adc_sequence_init_dt(&channel, &sequence)) {
        return ret;
    }
    if (int ret = adc_read_dt(&channel, &sequence)) {
        return ret;
    }

    int32_t mv = sample;
    if (int ret = adc_raw_to_millivolts_dt(&channel, &mv)) {
        return ret;
    }
    raw = sample;
    pin_mv = mv;
    return 0;
}

// Readings are small positive values; clamp anyway rather than wrap.
uint16_t to_uint16(int64_t value)
{
    if (value < 0) {
        return 0;
    }
    return value > UINT16_MAX ? UINT16_MAX : static_cast<uint16_t>(value);
}

} // namespace

int ZephyrBatterySensor::init()
{
    return setup(channel);
}

uint16_t ZephyrBatterySensor::get_battery_voltage_adc()
{
    int32_t raw = 0;
    int32_t pin_mv = 0;
    if (int ret = read(channel, raw, pin_mv)) {
        LOG_ERR("Battery voltage read failed (%d)", ret);
    }
    return to_uint16(raw);
}

uint16_t ZephyrBatterySensor::get_battery_voltage_mVDC()
{
    int32_t raw = 0;
    int32_t pin_mv = 0;
    if (int ret = read(channel, raw, pin_mv)) {
        LOG_ERR("Battery voltage read failed (%d)", ret);
    }
    return to_uint16(pin_mv);
}

int ZephyrCurrentSensor::init()
{
    return setup(channel);
}

uint16_t ZephyrCurrentSensor::get_current_mA()
{
    int32_t raw = 0;
    int32_t pin_mv = 0;
    if (int ret = read(channel, raw, pin_mv)) {
        LOG_ERR("Current read failed (%d)", ret);
        return 0;
    }

    // I = V / (Rsense * gain), with Rsense in milliohms: mV / 1.65 on this
    // board (v1's circuit was 1 mV = 1 mA).
    return to_uint16(int64_t { pin_mv } * 1000 * gain_div / (int64_t { sense_resistor_milli_ohms } * gain_mult));
}
```

## src/ZephyrAnalogSensors.h
```c
#ifndef ZEPHYR_ANALOG_SENSORS_H
#define ZEPHYR_ANALOG_SENSORS_H

#include "IBatterySensor.h"
#include "ICurrentSensor.h"

#include <zephyr/drivers/adc.h>

/**
 * IBatterySensor on an ADC channel behind the battery voltage divider.
 * Reports mV at the ADC pin, as v1 did; the cutoff constants account for
 * the divider.
 */
class ZephyrBatterySensor : public IBatterySensor {
    adc_dt_spec channel;

public:
    explicit ZephyrBatterySensor(const adc_dt_spec& channel)
        : channel(channel)
    {
    }

    /**
     * Set up the ADC channel.
     * @return 0 on success, a negative errno otherwise
     */
    int init();

    /**
     * @return raw 12-bit ADC value, or 0 if the read fails
     */
    uint16_t get_battery_voltage_adc() override;

    /**
     * @return mV at the ADC pin, or 0 if the read fails, which Battery treats
     * as a dead battery and so stops the robot
     */
    uint16_t get_battery_voltage_mVDC() override;
};

/**
 * ICurrentSensor for the INA169 high-side monitor: its output current
 * through the load resistor gives a voltage proportional to the total robot
 * current.
 */
class ZephyrCurrentSensor : public ICurrentSensor {
    adc_dt_spec channel;
    uint32_t sense_resistor_milli_ohms;
    uint32_t gain_mult;
    uint32_t gain_div;

public:
    /**
     * @param[in] channel ADC channel on the INA169 output
     * @param[in] sense_resistor_milli_ohms sense resistor value
     * @param[in] gain_mult, gain_div voltage gain from the sense resistor to
     * the ADC pin, as a fraction (INA169 transconductance x load resistor)
     */
    ZephyrCurrentSensor(
        const adc_dt_spec& channel, uint32_t sense_resistor_milli_ohms, uint32_t gain_mult, uint32_t gain_div)
        : channel(channel)
        , sense_resistor_milli_ohms(sense_resistor_milli_ohms)
        , gain_mult(gain_mult)
        , gain_div(gain_div)
    {
    }

    /**
     * Set up the ADC channel.
     * @return 0 on success, a negative errno otherwise
     */
    int init();

    /**
     * @return total robot current in mA, or 0 if the read fails
     */
    uint16_t get_current_mA() override;
};

#endif // ZEPHYR_ANALOG_SENSORS_H
```

## src/ZephyrMotorController.cpp
```c
#include "ZephyrMotorController.h"

#include "MotionConstants.h"

int ZephyrMotorController::init()
{
    if (!pwm_is_ready_dt(&enable) || !gpio_is_ready_dt(&phase)) {
        return -ENODEV;
    }
    if (int ret = gpio_pin_configure_dt(&phase, GPIO_OUTPUT_INACTIVE)) {
        return ret;
    }
    stop();
    return 0;
}

bool ZephyrMotorController::set_speed(int speed)
{
    if (speed > MAX_SPEED || speed < -MAX_SPEED) {
        return false;
    }

    if (gpio_pin_set_dt(&phase, speed >= 0)) {
        return false;
    }

    // Same duty as v1's analogWrite(speed): |speed| / MAX_SPEED of the period.
    auto magnitude = static_cast<uint32_t>(speed < 0 ? -speed : speed);
    auto pulse = static_cast<uint32_t>(static_cast<uint64_t>(enable.period) * magnitude / MAX_SPEED);
    return pwm_set_pulse_dt(&enable, pulse) == 0;
}

void ZephyrMotorController::stop()
{
    // As in v1, stopping only drops the duty to 0 and leaves PH as it is.
    pwm_set_pulse_dt(&enable, 0);
}
```

## src/ZephyrMotorController.h
```c
#ifndef ZEPHYR_MOTOR_CONTROLLER_H
#define ZEPHYR_MOTOR_CONTROLLER_H

#include "IMotorController.h"

#include <zephyr/drivers/gpio.h>
#include <zephyr/drivers/pwm.h>

/**
 * IMotorController for a DRV8874 in PH/EN mode: a PWM on EN sets the speed,
 * PH the direction (active = forward).
 */
class ZephyrMotorController : public IMotorController {
    pwm_dt_spec enable;
    gpio_dt_spec phase;

public:
    ZephyrMotorController(const pwm_dt_spec& enable, const gpio_dt_spec& phase)
        : enable(enable)
        , phase(phase)
    {
    }

    /**
     * Configure PH and stop the motor. Call before handing the controller to
     * Motion, whose constructor stops the motor too.
     * @return 0 on success, a negative errno otherwise
     */
    int init();

    bool set_speed(int speed) override;
    void stop() override;
};

#endif // ZEPHYR_MOTOR_CONTROLLER_H
```

## src/ZephyrNusStream.cpp
```c
#include "ZephyrNusStream.h"

#include <etl/array.h>
#include <zephyr/bluetooth/bluetooth.h>
#include <zephyr/bluetooth/conn.h>
#include <zephyr/logging/log.h>

LOG_MODULE_DECLARE(wallckr);

namespace {

const etl::array<bt_data, 2> advertising_data {
    bt_data BT_DATA_BYTES(BT_DATA_FLAGS, (BT_LE_AD_GENERAL | BT_LE_AD_NO_BREDR)),
    bt_data BT_DATA(BT_DATA_NAME_COMPLETE, CONFIG_BT_DEVICE_NAME, sizeof(CONFIG_BT_DEVICE_NAME) - 1),
};

const etl::array<bt_data, 1> scan_response_data {
    bt_data BT_DATA_BYTES(BT_DATA_UUID128_ALL, BT_UUID_NUS_SRV_VAL),
};

void start_advertising(k_work*)
{
    if (int ret = bt_le_adv_start(BT_LE_ADV_CONN_FAST_1, advertising_data.data(), advertising_data.size(),
            scan_response_data.data(), scan_response_data.size())) {
        LOG_ERR("BLE: advertising failed to start (%d)", ret);
        return;
    }
    LOG_INF("BLE: advertising as \"%s\"", CONFIG_BT_DEVICE_NAME);
}

K_WORK_DEFINE(advertising_work, start_advertising);

// The stream that the GATT MTU callback, which has no context pointer,
// reports to. There is one NUS stream.
ZephyrNusStream* mtu_listener = nullptr;

void on_connected(bt_conn*, uint8_t error)
{
    if (error) {
        LOG_WRN("BLE: connection failed (0x%02x)", error);
        return;
    }
    LOG_INF("BLE: connected");
}

void on_disconnected(bt_conn*, uint8_t reason)
{
    LOG_INF("BLE: disconnected (0x%02x)", reason);
    // The next connection starts at the default ATT MTU again.
    if (mtu_listener) {
        mtu_listener->reset_max_payload();
    }
}

// Advertising stops on connection; restart it once the connection object is
// free again, as the Zephyr samples do.
void on_recycled()
{
    k_work_submit(&advertising_work);
}

BT_CONN_CB_DEFINE(connection_callbacks) = {
    .connected = on_connected,
    .disconnected = on_disconnected,
    .recycled = on_recycled,
};

} // namespace

void ZephyrNusStream::on_received(bt_conn*, const void* data, uint16_t length, void* context)
{
    auto* stream = static_cast<ZephyrNusStream*>(context);
    etl::span<const uint8_t> bytes(static_cast<const uint8_t*>(data), length);

    k_mutex_lock(&stream->rx_lock, K_FOREVER);
    for (auto byte : bytes) {
        stream->rx_buffer.push(byte);
    }
    k_mutex_unlock(&stream->rx_lock);

    k_event_post(&stream->events, stream->command_event);
}

void ZephyrNusStream::on_notifications_changed(bool enabled, void* context)
{
    auto* stream = static_cast<ZephyrNusStream*>(context);
    atomic_set(&stream->notifications_enabled, enabled ? 1 : 0);
    LOG_INF("BLE: telemetry %s", enabled ? "on" : "off");
}

void ZephyrNusStream::on_mtu_updated(bt_conn*, uint16_t tx, uint16_t)
{
    // A notification carries ATT MTU - 3 bytes; never more than tx_buffer.
    constexpr uint16_t NOTIFICATION_HEADER = 3;
    uint16_t payload = tx > NOTIFICATION_HEADER ? tx - NOTIFICATION_HEADER : DEFAULT_PAYLOAD;
    if (payload > TX_BUFFER_SIZE) {
        payload = TX_BUFFER_SIZE;
    }
    if (mtu_listener) {
        atomic_set(&mtu_listener->max_payload, payload);
    }
    LOG_INF("BLE: notification payload %u bytes", payload);
}

int ZephyrNusStream::init()
{
    k_mutex_init(&rx_lock);

    mtu_listener = this;
    gatt_callbacks.att_mtu_updated = on_mtu_updated;
    bt_gatt_cb_register(&gatt_callbacks);

    nus_callbacks.notif_enabled = on_notifications_changed;
    nus_callbacks.received = on_received;
    if (int ret = bt_nus_cb_register(&nus_callbacks, this)) {
        return ret;
    }
    if (int ret = bt_enable(nullptr)) {
        return ret;
    }
    k_work_submit(&advertising_work);
    return 0;
}

int ZephyrNusStream::available()
{
    k_mutex_lock(&rx_lock, K_FOREVER);
    auto count = static_cast<int>(rx_buffer.size());
    k_mutex_unlock(&rx_lock);
    return count;
}

int ZephyrNusStream::read()
{
    int byte = -1;

    k_mutex_lock(&rx_lock, K_FOREVER);
    if (!rx_buffer.empty()) {
        byte = rx_buffer.front();
        rx_buffer.pop();
    }
    k_mutex_unlock(&rx_lock);

    return byte;
}

size_t ZephyrNusStream::write(uint8_t c)
{
    return write(etl::span<const uint8_t>(&c, 1));
}

size_t ZephyrNusStream::write(etl::span<const uint8_t> data)
{
    if (data.empty() || !atomic_get(&notifications_enabled)) {
        tx_buffer.clear();
        return 0;
    }

    auto limit = static_cast<size_t>(atomic_get(&max_payload));
    if (tx_buffer.size() + data.size() > limit) {
        flush();
    }
    if (data.size() > limit) {
        // Too long for any notification on this connection; send it alone
        // and let the stack report the error. Telemetry packets (10 and 16
        // bytes) always fit the default 20-byte payload.
        return send(data) ? data.size() : 0;
    }

    tx_buffer.insert(tx_buffer.end(), data.begin(), data.end());
    return data.size();
}

bool ZephyrNusStream::flush()
{
    if (tx_buffer.empty()) {
        return true;
    }
    bool sent = atomic_get(&notifications_enabled) && send(tx_buffer);
    tx_buffer.clear();
    return sent;
}

bool ZephyrNusStream::send(etl::span<const uint8_t> data)
{
    // NULL: notify every subscribed connection; there is at most one.
    return bt_nus_send(nullptr, data.data(), static_cast<uint16_t>(data.size())) == 0;
}
```

## src/ZephyrNusStream.h
```c
#ifndef ZEPHYR_NUS_STREAM_H
#define ZEPHYR_NUS_STREAM_H

#include "IRobotIOStream.h"

#include <etl/circular_buffer.h>
#include <etl/vector.h>
#include <zephyr/bluetooth/gatt.h>
#include <zephyr/bluetooth/services/nus.h>
#include <zephyr/kernel.h>
#include <zephyr/sys/atomic.h>

/**
 * IRobotIOStream over the Nordic UART Service: ovladacka commands arrive on
 * the RX characteristic, telemetry packets leave as TX notifications.
 *
 * Received bytes are buffered for the control thread, which drains them with
 * available()/read(); each arrival also posts an event so the thread wakes up.
 *
 * Written bytes are collected and sent as few, MTU-sized notifications: a
 * notification goes out when the next write would not fit, and flush() sends
 * the rest. The control thread calls flush() at the end of every wake, so a
 * whole tick's telemetry usually leaves as one notification. ovladacka parses
 * a byte stream, so packet boundaries need not match notifications. Data is
 * dropped while no phone is subscribed.
 */
class ZephyrNusStream : public IRobotIOStream {
    // ovladacka commands are 3 bytes; this holds a burst of them. When full,
    // the oldest bytes are overwritten and the parser resynchronizes.
    static constexpr size_t RX_BUFFER_SIZE = 64;
    // Largest notification payload: the 247-byte ATT MTU prj.conf allows,
    // less the 3-byte notification header.
    static constexpr size_t TX_BUFFER_SIZE = 244;
    // Payload of the default 23-byte ATT MTU, until the phone negotiates more.
    static constexpr uint16_t DEFAULT_PAYLOAD = 20;

    k_event& events;
    uint32_t command_event;

    // Guards rx_buffer between the Bluetooth RX thread (on_received) and the
    // control thread. Both are threads, so a mutex suffices and, unlike a
    // spinlock, never masks interrupts (which would delay the ultrasonic echo
    // timestamps).
    k_mutex rx_lock { };
    etl::circular_buffer<uint8_t, RX_BUFFER_SIZE> rx_buffer;
    atomic_t notifications_enabled = ATOMIC_INIT(0);
    bt_nus_cb nus_callbacks { };

    // Only touched by the control thread (write() and flush()).
    etl::vector<uint8_t, TX_BUFFER_SIZE> tx_buffer;
    // Notification payload the current connection allows, set from the
    // Bluetooth thread when the ATT MTU changes.
    atomic_t max_payload = ATOMIC_INIT(DEFAULT_PAYLOAD);
    bt_gatt_cb gatt_callbacks { };

    static void on_received(bt_conn* conn, const void* data, uint16_t length, void* context);
    static void on_notifications_changed(bool enabled, void* context);
    static void on_mtu_updated(bt_conn* conn, uint16_t tx, uint16_t rx);

    bool send(etl::span<const uint8_t> data);

public:
    /**
     * @param[in] events event object the control thread waits on
     * @param[in] command_event event bit posted whenever bytes arrive
     */
    ZephyrNusStream(k_event& events, uint32_t command_event)
        : events(events)
        , command_event(command_event)
    {
    }

    /**
     * Enable Bluetooth, register the NUS callbacks and start advertising as
     * CONFIG_BT_DEVICE_NAME. Advertising restarts after every disconnect.
     * @return 0 on success, a negative errno otherwise
     */
    int init();

    int available() override;

    /**
     * @return the next received byte, or -1 if there is none (as Arduino's
     * Stream::read(), which v1 used)
     */
    int read() override;

    size_t write(uint8_t c) override;

    /**
     * Queue data for sending; sends the queued data first if data would not
     * fit in the same notification.
     * @return data.size() once queued, 0 if nobody is subscribed (the data is
     * dropped)
     */
    size_t write(etl::span<const uint8_t> data) override;

    /**
     * Send the queued data as one notification. Called by the control thread
     * at the end of every wake.
     * @return true if the data was sent or nothing was queued
     */
    bool flush();

    /**
     * Fall back to the default notification payload, for a new connection.
     */
    void reset_max_payload() { atomic_set(&max_payload, DEFAULT_PAYLOAD); }
};

#endif // ZEPHYR_NUS_STREAM_H
```

## src/ZephyrRobotIndicators.cpp
```c
#include "ZephyrRobotIndicators.h"

#include <etl/array.h>

int ZephyrRobotIndicators::init()
{
    for (const auto* led : etl::array { &state1, &state2, &error }) {
        if (!gpio_is_ready_dt(led)) {
            return -ENODEV;
        }
        if (int ret = gpio_pin_configure_dt(led, GPIO_OUTPUT_INACTIVE)) {
            return ret;
        }
    }
    return 0;
}

int ZephyrRobotIndicators::indicate_robot_state(RobotIndicatorState state)
{
    bool following = false;
    bool avoiding = false;

    switch (state) {
    case RobotIndicatorState::MOVING_AVOIDING:
        avoiding = true;
        break;
    case RobotIndicatorState::MOVING_FOLLOWING:
        following = true;
        break;
    case RobotIndicatorState::IDLE:
    case RobotIndicatorState::ERROR:
        break;
    }

    if (int ret = gpio_pin_set_dt(&state1, following)) {
        return ret;
    }
    return gpio_pin_set_dt(&state2, avoiding);
}

int ZephyrRobotIndicators::indicate_battery_warning()
{
    error_on = !error_on;
    return gpio_pin_set_dt(&error, error_on);
}
```

## src/ZephyrRobotIndicators.h
```c
#ifndef ZEPHYR_ROBOT_INDICATORS_H
#define ZEPHYR_ROBOT_INDICATORS_H

#include "IRobotIndicators.h"

#include <zephyr/drivers/gpio.h>

/**
 * IRobotIndicators on the Button/LED shield, with v1's LED meanings:
 * STATE1 (v1's LED1) = wall following, STATE2 (LED2) = avoiding, ERR (LED5)
 * toggles on every battery warning. Polarity comes from the devicetree.
 */
class ZephyrRobotIndicators : public IRobotIndicators {
    gpio_dt_spec state1;
    gpio_dt_spec state2;
    gpio_dt_spec error;
    bool error_on = false;

public:
    ZephyrRobotIndicators(const gpio_dt_spec& state1, const gpio_dt_spec& state2, const gpio_dt_spec& error)
        : state1(state1)
        , state2(state2)
        , error(error)
    {
    }

    /**
     * Configure the LEDs, all off.
     * @return 0 on success, a negative errno otherwise
     */
    int init();

    int indicate_robot_state(RobotIndicatorState state) override;

    /**
     * Toggle the ERR LED; called on every status check while the battery is
     * dead, so it blinks at half the status check rate, as in v1.
     */
    int indicate_battery_warning() override;
};

#endif // ZEPHYR_ROBOT_INDICATORS_H
```

## src/ZephyrSteeringServo.cpp
```c
#include "ZephyrSteeringServo.h"

namespace {
constexpr int MAX_ANGLE = 180;
constexpr uint32_t INITIAL_PULSE_NS = PWM_USEC(1500);
} // namespace

int ZephyrSteeringServo::init()
{
    if (!pwm_is_ready_dt(&servo)) {
        return -ENODEV;
    }
    return pwm_set_pulse_dt(&servo, INITIAL_PULSE_NS);
}

bool ZephyrSteeringServo::set_angle(int angle)
{
    if (angle < 0) {
        angle = 0;
    } else if (angle > MAX_ANGLE) {
        angle = MAX_ANGLE;
    }

    uint32_t pulse_ns = min_pulse_ns + (max_pulse_ns - min_pulse_ns) * angle / MAX_ANGLE;
    return pwm_set_pulse_dt(&servo, pulse_ns) == 0;
}
```

## src/ZephyrSteeringServo.h
```c
#ifndef ZEPHYR_STEERING_SERVO_H
#define ZEPHYR_STEERING_SERVO_H

#include "ISteeringServo.h"

#include <zephyr/drivers/pwm.h>

/**
 * ISteeringServo for an RC servo on a PWM channel, mapping 0-180 degrees
 * linearly onto [min_pulse_ns, max_pulse_ns] like v1's Arduino Servo library.
 */
class ZephyrSteeringServo : public ISteeringServo {
    pwm_dt_spec servo;
    uint32_t min_pulse_ns;
    uint32_t max_pulse_ns;

public:
    ZephyrSteeringServo(const pwm_dt_spec& servo, uint32_t min_pulse_ns, uint32_t max_pulse_ns)
        : servo(servo)
        , min_pulse_ns(min_pulse_ns)
        , max_pulse_ns(max_pulse_ns)
    {
    }

    /**
     * Start sending pulses at 1500 us, the position the Arduino Servo library
     * holds from attach() until the first write().
     * @return 0 on success, a negative errno otherwise
     */
    int init();

    /**
     * @param[in] angle desired angle in degrees; values outside [0, 180] are
     * clamped, as Arduino's Servo::write() does
     */
    bool set_angle(int angle) override;
};

#endif // ZEPHYR_STEERING_SERVO_H
```

## src/ZephyrUltrasonicSensor.cpp
```c
#include "ZephyrUltrasonicSensor.h"

namespace {
// NewPing's constants, so readings and timeouts match v1.
constexpr uint32_t US_ROUNDTRIP_CM = 57;
// How long the sensor may take to start its echo pulse after the trigger.
constexpr uint32_t MAX_SENSOR_DELAY_US = 5800;
constexpr uint32_t TRIGGER_PULSE_US = 10;
} // namespace

void ZephyrUltrasonicSensor::on_echo_edge(const device*, gpio_callback* callback, gpio_port_pins_t)
{
    uint32_t now = k_cycle_get_32();
    Echo* echo = CONTAINER_OF(callback, Echo, callback);

    // Edges outside a measurement, e.g. the end of an echo that already
    // timed out, are ignored.
    if (!echo->armed) {
        return;
    }
    if (gpio_pin_get_dt(&echo->pin) > 0) {
        echo->rise_cycles = now;
        echo->rise_seen = true;
        k_sem_give(&echo->started);
    } else if (echo->rise_seen) {
        echo->width_cycles = now - echo->rise_cycles;
        echo->armed = false;
        k_sem_give(&echo->ended);
    }
}

int ZephyrUltrasonicSensor::init()
{
    if (!gpio_is_ready_dt(&trigger) || !gpio_is_ready_dt(&echo.pin)) {
        return -ENODEV;
    }

    k_sem_init(&echo.started, 0, 1);
    k_sem_init(&echo.ended, 0, 1);
    if (int ret = gpio_pin_configure_dt(&trigger, GPIO_OUTPUT_INACTIVE)) {
        return ret;
    }
    if (int ret = gpio_pin_configure_dt(&echo.pin, GPIO_INPUT)) {
        return ret;
    }
    if (int ret = gpio_pin_interrupt_configure_dt(&echo.pin, GPIO_INT_EDGE_BOTH)) {
        return ret;
    }
    gpio_init_callback(&echo.callback, on_echo_edge, BIT(echo.pin.pin));
    return gpio_add_callback_dt(&echo.pin, &echo.callback);
}

uint32_t ZephyrUltrasonicSensor::ping()
{
    // NewPing's limit: the round trip for one more than the maximum distance.
    const uint32_t max_echo_us = (max_cm_distance + 1) * US_ROUNDTRIP_CM + US_ROUNDTRIP_CM / 2;

    k_sem_reset(&echo.started);
    k_sem_reset(&echo.ended);
    echo.rise_seen = false;
    echo.armed = true;

    gpio_pin_set_dt(&trigger, 1);
    k_busy_wait(TRIGGER_PULSE_US);
    gpio_pin_set_dt(&trigger, 0);

    if (k_sem_take(&echo.started, K_USEC(MAX_SENSOR_DELAY_US)) != 0
        || k_sem_take(&echo.ended, K_USEC(max_echo_us)) != 0) {
        echo.armed = false;
        return 0;
    }

    uint32_t width_us = k_cyc_to_us_floor32(echo.width_cycles);
    return width_us <= max_echo_us ? width_us : 0;
}

bool ZephyrUltrasonicSensor::trigger_measurement()
{
    // As in v1: NewPing reports no echo and out-of-range alike as 0, and both
    // read as the maximum distance.
    measurement_raw_cm = ping() / US_ROUNDTRIP_CM;
    if (measurement_raw_cm == 0) {
        measurement_raw_cm = max_cm_distance;
    }

    return true;
}

unsigned long ZephyrUltrasonicSensor::get_distance_raw_cm()
{
    trigger_measurement();

    return measurement_raw_cm;
}

unsigned long ZephyrUltrasonicSensor::get_distance_filtered_cm()
{
    trigger_measurement();

    measurement_filtered_cm = sonar_filter.next(static_cast<int>(measurement_raw_cm));

    return measurement_filtered_cm;
}
```

## src/ZephyrUltrasonicSensor.h
```c
#ifndef ZEPHYR_ULTRASONIC_SENSOR_H
#define ZEPHYR_ULTRASONIC_SENSOR_H

#include "ExpFilter.h"
#include "IDistanceSensor.h"

#include <zephyr/drivers/gpio.h>
#include <zephyr/kernel.h>

/**
 * IDistanceSensor for an HY-SRF05 (HC-SR04 timing), measured the way v1's
 * NewPing did: echo edges are timestamped from the GPIO interrupt, the wait
 * gives up at the maximum distance, and no echo or an out-of-range one reads
 * as that maximum.
 */
class ZephyrUltrasonicSensor : public IDistanceSensor {
    // State shared with the echo interrupt. A separate standard-layout struct,
    // so the callback can find it with CONTAINER_OF.
    struct Echo {
        gpio_callback callback;
        gpio_dt_spec pin;
        k_sem started;
        k_sem ended;
        uint32_t rise_cycles;
        uint32_t width_cycles;
        bool armed;
        bool rise_seen;
    };

    gpio_dt_spec trigger;
    unsigned int max_cm_distance;
    Echo echo;

    unsigned long measurement_raw_cm = 0;
    unsigned long measurement_filtered_cm = 0;
    static constexpr int FILTER_N = 4;
    ExpFilter<int, FILTER_N> sonar_filter;

    static void on_echo_edge(const device* port, gpio_callback* callback, gpio_port_pins_t pins);

    // Echo pulse width in microseconds, or 0 for no echo or one longer than
    // max_cm_distance (NewPing's NO_ECHO).
    uint32_t ping();

public:
    ZephyrUltrasonicSensor(const gpio_dt_spec& trigger, const gpio_dt_spec& echo_pin, unsigned int max_cm_distance)
        : trigger(trigger)
        , max_cm_distance(max_cm_distance)
        , echo { .pin = echo_pin }
    {
    }

    /**
     * Configure TRIG and the ECHO interrupt.
     * @return 0 on success, a negative errno otherwise
     */
    int init();

    /**
     * Ping once; blocks for up to ~17 ms (NewPing's 5.8 ms wait for the echo
     * to start, then ~11.5 ms for 200 cm).
     * @return always true, as in v1
     */
    bool trigger_measurement() override;
    unsigned long get_distance_raw_cm() override;
    unsigned long get_distance_filtered_cm() override;
};

#endif // ZEPHYR_ULTRASONIC_SENSOR_H
```
