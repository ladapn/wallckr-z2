## CMakeLists.txt
```
# Unit tests for firmware/lib (the code ported from v1's lib/), run on native_sim:
#   west twister -p native_sim -T firmware/tests

cmake_minimum_required(VERSION 3.20.0)

find_package(Zephyr REQUIRED HINTS $ENV{ZEPHYR_BASE})
project(wallckr_lib_tests LANGUAGES CXX)

add_subdirectory(../../lib wallckr_lib)
target_link_libraries(app PRIVATE wallckr_lib)

target_include_directories(app PRIVATE ${CMAKE_CURRENT_LIST_DIR}/../common)

target_sources(app PRIVATE
    src/test_auto_steering.cpp
    src/test_battery.cpp
    src/test_closed_loop_motor.cpp
    src/test_command_decoder.cpp
    src/test_filter.cpp
    src/test_pi_controller.cpp
    src/test_regulator.cpp
    src/test_robot.cpp
    src/test_robot_packets.cpp
)
```

## prj.conf
```kconfig
CONFIG_ZTEST=y

# Same language settings as the apps: C++23 on the minimal C++ library.
CONFIG_CPP=y
CONFIG_STD_CPP23=y
CONFIG_MINIMAL_LIBCPP=y
CONFIG_CPP_EXCEPTIONS=n
CONFIG_CPP_RTTI=n
# firmware/lib uses ETL containers.
CONFIG_ETL=y
```

## src/test_auto_steering.cpp
```c
#include "AutoSteering.h"

#include <zephyr/ztest.h>

namespace {
// Pass-through regulator/filter stand-ins so tests can exercise
// AutoSteering's FOLLOWING/AVOIDING state machine in isolation from
// the regulator and filter math, which are covered by their own tests.
class IdentityRegulator : public Regulator<int> {
protected:
    int regulator_equation(int e) override { return e; }

public:
    // Action limits mirror Regulator's old hardcoded defaults - irrelevant to
    // what this test double is standing in for here.
    IdentityRegulator()
        : Regulator<int>(1, 0, 0, 45, -30)
    {
    }
};

class IdentityFilter : public IFilter<int> {
public:
    int next(int input) override { return input; }
};

// Mirrors AutoSteering's internal thresholds (see AutoSteering.h) so test
// measurements can be expressed relative to them instead of magic numbers.
const int SIDE_DISTANCE_SETPOINT_CM = 25;
const int TURNING_RADIUS_CM = 15;
const int AVOIDING_DISTANCE_RIGHT_FRONT_THR_CM = 15;
const int AVOIDING_DISTANCE_HYSTERESIS_CM = 20;
const int AVOIDING_DISTANCE_THR_CM = SIDE_DISTANCE_SETPOINT_CM + TURNING_RADIUS_CM;

const int FAR_DISTANCE_CM = 100; // clearly outside any threshold used below

void assert_state(AutoSteering<int>& auto_steering, SteeringState expected)
{
    zassert_equal(static_cast<int>(auto_steering.get_steering_state()), static_cast<int>(expected));
}
} // namespace

ZTEST(auto_steering, test_starts_in_following_state)
{
    IdentityRegulator regulator;
    IdentityFilter filter;
    AutoSteering<int> auto_steering(SIDE_DISTANCE_SETPOINT_CM, regulator, filter);

    assert_state(auto_steering, SteeringState::FOLLOWING);
}

ZTEST(auto_steering, test_following_enters_avoiding_on_close_front_obstacle)
{
    IdentityRegulator regulator;
    IdentityFilter filter;
    AutoSteering<int> auto_steering(SIDE_DISTANCE_SETPOINT_CM, regulator, filter);

    DistanceMeasurements measurements;
    measurements.front_distance_cm = AVOIDING_DISTANCE_THR_CM - 1;
    measurements.right_front_distance_cm = FAR_DISTANCE_CM;
    measurements.right_distance_cm = SIDE_DISTANCE_SETPOINT_CM;

    auto_steering.get_steering_command(measurements);

    assert_state(auto_steering, SteeringState::AVOIDING);
}

ZTEST(auto_steering, test_following_enters_avoiding_on_close_right_front_obstacle)
{
    IdentityRegulator regulator;
    IdentityFilter filter;
    AutoSteering<int> auto_steering(SIDE_DISTANCE_SETPOINT_CM, regulator, filter);

    DistanceMeasurements measurements;
    measurements.front_distance_cm = FAR_DISTANCE_CM;
    measurements.right_front_distance_cm = AVOIDING_DISTANCE_RIGHT_FRONT_THR_CM - 1;
    measurements.right_distance_cm = SIDE_DISTANCE_SETPOINT_CM;

    auto_steering.get_steering_command(measurements);

    assert_state(auto_steering, SteeringState::AVOIDING);
}

ZTEST(auto_steering, test_avoiding_commands_max_left_steering)
{
    IdentityRegulator regulator;
    IdentityFilter filter;
    AutoSteering<int> auto_steering(SIDE_DISTANCE_SETPOINT_CM, regulator, filter);

    DistanceMeasurements measurements;
    measurements.front_distance_cm = AVOIDING_DISTANCE_THR_CM - 1;
    measurements.right_front_distance_cm = FAR_DISTANCE_CM;
    measurements.right_distance_cm = SIDE_DISTANCE_SETPOINT_CM;

    auto_steering.get_steering_command(measurements); // FOLLOWING -> AVOIDING
    auto servo = auto_steering.get_steering_command(measurements); // stays AVOIDING

    zassert_equal(servo, SERVO_MAX_LEFT);
}

ZTEST(auto_steering, test_avoiding_returns_to_following_once_clear)
{
    IdentityRegulator regulator;
    IdentityFilter filter;
    AutoSteering<int> auto_steering(SIDE_DISTANCE_SETPOINT_CM, regulator, filter);

    DistanceMeasurements close_measurements;
    close_measurements.front_distance_cm = AVOIDING_DISTANCE_THR_CM - 1;
    close_measurements.right_front_distance_cm = FAR_DISTANCE_CM;
    close_measurements.right_distance_cm = SIDE_DISTANCE_SETPOINT_CM;
    auto_steering.get_steering_command(close_measurements); // enter AVOIDING

    // Recovery needs front > AVOIDING_DISTANCE_THR_CM + hysteresis and
    // right_front > AVOIDING_DISTANCE_THR_CM - right front threshold
    DistanceMeasurements clear_measurements;
    clear_measurements.front_distance_cm = AVOIDING_DISTANCE_THR_CM + AVOIDING_DISTANCE_HYSTERESIS_CM + 1;
    clear_measurements.right_front_distance_cm = AVOIDING_DISTANCE_THR_CM - AVOIDING_DISTANCE_RIGHT_FRONT_THR_CM + 1;
    clear_measurements.right_distance_cm = SIDE_DISTANCE_SETPOINT_CM;

    auto_steering.get_steering_command(clear_measurements);

    assert_state(auto_steering, SteeringState::FOLLOWING);
}

ZTEST(auto_steering, test_avoiding_stays_avoiding_until_both_thresholds_clear)
{
    IdentityRegulator regulator;
    IdentityFilter filter;
    AutoSteering<int> auto_steering(SIDE_DISTANCE_SETPOINT_CM, regulator, filter);

    DistanceMeasurements close_measurements;
    close_measurements.front_distance_cm = AVOIDING_DISTANCE_THR_CM - 1;
    close_measurements.right_front_distance_cm = FAR_DISTANCE_CM;
    close_measurements.right_distance_cm = SIDE_DISTANCE_SETPOINT_CM;
    auto_steering.get_steering_command(close_measurements); // enter AVOIDING

    // Front is clear, but right front sits exactly at its recovery threshold
    // rather than past it, so recovery must not trigger yet (condition is '>')
    DistanceMeasurements partially_clear_measurements;
    partially_clear_measurements.front_distance_cm = AVOIDING_DISTANCE_THR_CM + AVOIDING_DISTANCE_HYSTERESIS_CM + 1;
    partially_clear_measurements.right_front_distance_cm
        = AVOIDING_DISTANCE_THR_CM - AVOIDING_DISTANCE_RIGHT_FRONT_THR_CM;
    partially_clear_measurements.right_distance_cm = SIDE_DISTANCE_SETPOINT_CM;

    auto_steering.get_steering_command(partially_clear_measurements);

    assert_state(auto_steering, SteeringState::AVOIDING);
}

ZTEST_SUITE(auto_steering, NULL, NULL, NULL, NULL, NULL);
```

## src/test_battery.cpp
```c
#include "Battery.h"
#include "IRobotIOStream.h"
#include "RobotPackets.h"
#include "RobotPrinter.h"

#include <zephyr/ztest.h>

namespace {
// Stub battery sensor with a settable voltage reading, so tests can
// simulate the pack draining/recovering without real hardware.
class StubBatterySensor : public IBatterySensor {
public:
    uint16_t voltage_mVDC = 0;
    uint16_t get_battery_voltage_adc() override { return 0; }
    uint16_t get_battery_voltage_mVDC() override { return voltage_mVDC; }
};

// Stub current sensor with a settable mA reading.
class StubCurrentSensor : public ICurrentSensor {
public:
    uint16_t current_mA = 0;
    uint16_t get_current_mA() override { return current_mA; }
};

// Minimal IRobotIOStream that just captures what was written, so tests
// can inspect the telemetry Battery::is_ok sends out.
class CapturingIOStream : public IRobotIOStream {
public:
    uint8_t buffer[32] = { 0 };
    size_t bytes_written = 0;

    int available() override { return 0; }
    int read() override { return -1; }
    size_t write(uint8_t c) override
    {
        if (bytes_written < sizeof(buffer)) {
            buffer[bytes_written] = c;
        }
        bytes_written++;
        return 1;
    }
    size_t write(etl::span<const uint8_t> data) override
    {
        for (auto byte : data) {
            write(byte);
        }
        return data.size();
    }
};

const uint16_t CUTOFF_mVDC = 450;
const uint16_t HYSTERESIS_mVDC = 50;
} // namespace

ZTEST(battery, test_battery_ok_above_cutoff)
{
    StubBatterySensor sensor;
    sensor.voltage_mVDC = CUTOFF_mVDC + 1;
    StubCurrentSensor current_sensor;
    CapturingIOStream io_stream;
    RobotPrinter printer(io_stream);
    Battery battery(sensor, current_sensor, printer, CUTOFF_mVDC, HYSTERESIS_mVDC);

    zassert_true(battery.is_ok(0));
}

ZTEST(battery, test_battery_dead_at_or_below_cutoff)
{
    StubBatterySensor sensor;
    sensor.voltage_mVDC = CUTOFF_mVDC; // exactly at cutoff, not below
    StubCurrentSensor current_sensor;
    CapturingIOStream io_stream;
    RobotPrinter printer(io_stream);
    Battery battery(sensor, current_sensor, printer, CUTOFF_mVDC, HYSTERESIS_mVDC);

    zassert_false(battery.is_ok(0));
}

ZTEST(battery, test_battery_stays_dead_until_hysteresis_cleared)
{
    StubBatterySensor sensor;
    StubCurrentSensor current_sensor;
    CapturingIOStream io_stream;
    RobotPrinter printer(io_stream);
    Battery battery(sensor, current_sensor, printer, CUTOFF_mVDC, HYSTERESIS_mVDC);

    sensor.voltage_mVDC = CUTOFF_mVDC - 1;
    battery.is_ok(0); // drains below cutoff, enters dead state

    // Recovered above cutoff, but sitting exactly at (not past) the
    // hysteresis band - must not be considered ok yet.
    sensor.voltage_mVDC = CUTOFF_mVDC + HYSTERESIS_mVDC;
    zassert_false(battery.is_ok(1000));
}

ZTEST(battery, test_battery_recovers_once_hysteresis_cleared)
{
    StubBatterySensor sensor;
    StubCurrentSensor current_sensor;
    CapturingIOStream io_stream;
    RobotPrinter printer(io_stream);
    Battery battery(sensor, current_sensor, printer, CUTOFF_mVDC, HYSTERESIS_mVDC);

    sensor.voltage_mVDC = CUTOFF_mVDC - 1;
    battery.is_ok(0); // drains below cutoff, enters dead state

    sensor.voltage_mVDC = CUTOFF_mVDC + HYSTERESIS_mVDC + 1;
    zassert_true(battery.is_ok(1000));
}

ZTEST(battery, test_battery_sends_status_packet_with_measured_voltage)
{
    StubBatterySensor sensor;
    sensor.voltage_mVDC = 1234;
    StubCurrentSensor current_sensor;
    CapturingIOStream io_stream;
    RobotPrinter printer(io_stream);
    Battery battery(sensor, current_sensor, printer, CUTOFF_mVDC, HYSTERESIS_mVDC);

    battery.is_ok(2000);

    zassert_equal(io_stream.bytes_written, StatusPacket::SERIALIZED_SIZE);

    // battery_voltage_mvdc is a little-endian uint16_t right after id (1
    // byte), tick (4 bytes) and version_ID (4 bytes) - see RobotPackets.h
    uint16_t reported_voltage_mVDC
        = static_cast<uint16_t>(io_stream.buffer[9]) | (static_cast<uint16_t>(io_stream.buffer[10]) << 8);
    zassert_equal(reported_voltage_mVDC, 1234);
}

ZTEST(battery, test_battery_sends_status_packet_with_measured_current)
{
    StubBatterySensor sensor;
    StubCurrentSensor current_sensor;
    current_sensor.current_mA = 512;
    CapturingIOStream io_stream;
    RobotPrinter printer(io_stream);
    Battery battery(sensor, current_sensor, printer, CUTOFF_mVDC, HYSTERESIS_mVDC);

    battery.is_ok(2000);

    // total_current_mA and motor_current_mA are little-endian uint16_t
    // fields right after battery_voltage_mvdc - see RobotPackets.h
    uint16_t reported_total_current_mA
        = static_cast<uint16_t>(io_stream.buffer[11]) | (static_cast<uint16_t>(io_stream.buffer[12]) << 8);
    uint16_t reported_motor_current_mA
        = static_cast<uint16_t>(io_stream.buffer[13]) | (static_cast<uint16_t>(io_stream.buffer[14]) << 8);

    // total current comes from the sensor...
    zassert_equal(reported_total_current_mA, 512);
    // ...but there's no motor-specific sensor, so it must be flagged as not
    // measured rather than sent as a misleading 0.
    zassert_equal(reported_motor_current_mA, 0xFFFF);
}

ZTEST_SUITE(battery, NULL, NULL, NULL, NULL, NULL);
```

## src/test_closed_loop_motor.cpp
```c
#include "ClosedLoopMotorController.h"

#include <zephyr/ztest.h>

namespace {

// Records the duty it was given, as the open-loop motor controller.
class FakeMotor : public IMotorController {
public:
    int speed = 0;
    int set_speed_calls = 0;
    int stop_calls = 0;

    bool set_speed(int new_speed) override
    {
        speed = new_speed;
        set_speed_calls++;
        return true;
    }
    void stop() override
    {
        speed = 0;
        stop_calls++;
    }
};

// Reports the same count every period, or a read failure.
class FakeEncoder : public IWheelEncoder {
public:
    int32_t counts_per_read = 0;
    bool fails = false;

    bool read_counts(int32_t& counts) override
    {
        if (fails) {
            return false;
        }
        counts = counts_per_read;
        return true;
    }
};

const int PERIOD_MS = 100;
const float MAX_COUNTS_PER_S = 2000.0f;
const float KP = 0.1f;

} // namespace

ZTEST(closed_loop_motor, test_rejects_speed_out_of_range)
{
    FakeMotor motor;
    FakeEncoder encoder;
    ClosedLoopMotorController controller(motor, encoder, KP, 0.0f, PERIOD_MS, MAX_COUNTS_PER_S);

    zassert_false(controller.set_speed(256));
    zassert_false(controller.set_speed(-256));
    zassert_true(controller.set_speed(255));
    zassert_true(controller.set_speed(-255));
}

ZTEST(closed_loop_motor, test_duty_changes_only_on_update)
{
    FakeMotor motor;
    FakeEncoder encoder;
    ClosedLoopMotorController controller(motor, encoder, KP, 0.0f, PERIOD_MS, MAX_COUNTS_PER_S);

    controller.set_speed(255);
    zassert_equal(motor.set_speed_calls, 0);

    controller.update();
    zassert_equal(motor.set_speed_calls, 1);
}

ZTEST(closed_loop_motor, test_proportional_duty_from_speed_error)
{
    FakeMotor motor;
    FakeEncoder encoder;
    ClosedLoopMotorController controller(motor, encoder, KP, 0.0f, PERIOD_MS, MAX_COUNTS_PER_S);

    // Target 2000 counts/s; 100 counts per 100 ms is 1000 counts/s.
    controller.set_speed(255);
    encoder.counts_per_read = 100;
    controller.update();

    zassert_equal(motor.speed, 100); // 0.1 * (2000 - 1000)
}

ZTEST(closed_loop_motor, test_speed_is_a_fraction_of_max)
{
    FakeMotor motor;
    FakeEncoder encoder;
    ClosedLoopMotorController controller(motor, encoder, KP, 0.0f, PERIOD_MS, MAX_COUNTS_PER_S);

    controller.set_speed(51); // 51 / 255 of 2000 = 400 counts/s
    controller.update();

    zassert_equal(motor.speed, 40);
}

ZTEST(closed_loop_motor, test_backward)
{
    FakeMotor motor;
    FakeEncoder encoder;
    ClosedLoopMotorController controller(motor, encoder, KP, 0.0f, PERIOD_MS, MAX_COUNTS_PER_S);

    controller.set_speed(-255);
    encoder.counts_per_read = -100;
    controller.update();

    zassert_equal(motor.speed, -100);
}

ZTEST(closed_loop_motor, test_integral_raises_duty_while_too_slow)
{
    FakeMotor motor;
    FakeEncoder encoder;
    // 0.5 * 1000 counts/s * 0.1 s = 50 duty per period
    ClosedLoopMotorController controller(motor, encoder, 0.0f, 0.5f, PERIOD_MS, MAX_COUNTS_PER_S);

    controller.set_speed(255);
    encoder.counts_per_read = 100;
    controller.update();
    zassert_equal(motor.speed, 50);
    controller.update();
    zassert_equal(motor.speed, 100);
}

ZTEST(closed_loop_motor, test_duty_is_clamped)
{
    FakeMotor motor;
    FakeEncoder encoder;
    ClosedLoopMotorController controller(motor, encoder, 1.0f, 0.0f, PERIOD_MS, MAX_COUNTS_PER_S);

    controller.set_speed(255);
    controller.update();
    zassert_equal(motor.speed, 255);

    controller.set_speed(-255);
    controller.update();
    zassert_equal(motor.speed, -255);
}

ZTEST(closed_loop_motor, test_zero_speed_stops_at_once_and_stays_stopped)
{
    FakeMotor motor;
    FakeEncoder encoder;
    ClosedLoopMotorController controller(motor, encoder, KP, 0.0f, PERIOD_MS, MAX_COUNTS_PER_S);

    controller.set_speed(255);
    controller.update();
    controller.set_speed(0);
    zassert_equal(motor.stop_calls, 1);
    zassert_equal(motor.speed, 0);

    int calls = motor.set_speed_calls;
    encoder.counts_per_read = 50; // still coasting
    controller.update();
    zassert_equal(motor.set_speed_calls, calls, "the loop must not drive towards zero");
    zassert_equal(motor.speed, 0);
}

ZTEST(closed_loop_motor, test_stop_resets_target_and_integral)
{
    FakeMotor motor;
    FakeEncoder encoder;
    ClosedLoopMotorController controller(motor, encoder, 0.0f, 0.5f, PERIOD_MS, MAX_COUNTS_PER_S);

    controller.set_speed(255);
    controller.update();
    controller.update(); // integral at 100
    controller.stop();
    zassert_equal(motor.speed, 0);

    controller.update();
    zassert_equal(motor.speed, 0, "stop() clears the target");

    controller.set_speed(255);
    controller.update();
    zassert_equal(motor.speed, 100, "integral restarts from zero"); // 0.5 * 2000 * 0.1
}

ZTEST(closed_loop_motor, test_encoder_failure_stops_motor_and_resets_integral)
{
    FakeMotor motor;
    FakeEncoder encoder;
    ClosedLoopMotorController controller(motor, encoder, 0.0f, 0.5f, PERIOD_MS, MAX_COUNTS_PER_S);

    controller.set_speed(255);
    encoder.counts_per_read = 100;
    controller.update();
    controller.update(); // duty 100

    encoder.fails = true;
    controller.update();
    zassert_equal(motor.stop_calls, 1);
    zassert_equal(motor.speed, 0);

    // The target survives; the loop restarts from zero integral.
    encoder.fails = false;
    controller.update();
    zassert_equal(motor.speed, 50);
}

ZTEST_SUITE(closed_loop_motor, NULL, NULL, NULL, NULL, NULL);
```

## src/test_command_decoder.cpp
```c
#include "BLEJoystickDecoder.h"
#include "ExternalCommandDecoder.h"
#include "MotionConstants.h"
#include "OvladackaParser.h"
#include "RobotCommand.h"
#include "simulated_uart.h"

#include <zephyr/ztest.h>

namespace {

// Compare fields individually rather than raw struct bytes: RobotCommand
// has padding between its int fields and the trailing bool, and that
// padding is uninitialized - a memcmp of two separately constructed
// instances can spuriously differ even when every field matches.
void assert_commands_equal(const RobotCommand& expected, const RobotCommand& actual)
{
    zassert_equal(actual.desired_speed, expected.desired_speed);
    zassert_equal(actual.desired_servo_angle, expected.desired_servo_angle);
    zassert_equal(actual.enable_automatic_operation, expected.enable_automatic_operation);
}

} // namespace

ZTEST(command_decoder, test_simulated_uart)
{
    char in_data[] = "abcdEFGH";
    auto num_of_elements = sizeof(in_data) / sizeof(char);
    SimulatedUART sim_uart(in_data, num_of_elements);

    char out_data[num_of_elements];
    for (unsigned long i = 0; i < num_of_elements; i++) {
        out_data[i] = sim_uart.read();
    }

    zassert_mem_equal(out_data, in_data, num_of_elements);
}

ZTEST(command_decoder, test_check_external_command_speed_ovladacka)
{
    OvladackaParser in_parser;
    char in_data[] = ":a!";
    SimulatedUART sim_uart(in_data, sizeof(in_data) / sizeof(char));
    ExternalCommandDecoder ext_comm_dec(sim_uart, in_parser);

    RobotCommand rob_cmd_actual;
    RobotCommand rob_cmd_expected;

    rob_cmd_expected.desired_speed = SPEED_INCREMENT;

    ext_comm_dec.check_external_command(rob_cmd_actual);

    assert_commands_equal(rob_cmd_expected, rob_cmd_actual);
}

ZTEST(command_decoder, test_check_external_command_angle_ovladacka)
{
    OvladackaParser in_parser;
    char in_data[] = ":b!";
    SimulatedUART sim_uart(in_data, sizeof(in_data) / sizeof(char));
    ExternalCommandDecoder ext_comm_dec(sim_uart, in_parser);

    RobotCommand rob_cmd_actual;
    RobotCommand rob_cmd_expected;

    rob_cmd_expected.desired_servo_angle = SERVO_CENTER - SERVO_INCREMENT;

    ext_comm_dec.check_external_command(rob_cmd_actual);

    assert_commands_equal(rob_cmd_expected, rob_cmd_actual);
}

ZTEST(command_decoder, test_check_external_command_speed_BLE_joy)
{
    BLEJoystickDecoder in_parser;
    char in_data[] = { 'A', 'a', '\0' }; // Command to increase speed in BLE Joystick format
    SimulatedUART sim_uart(in_data, sizeof(in_data) / sizeof(char));
    ExternalCommandDecoder ext_comm_dec(sim_uart, in_parser);

    RobotCommand rob_cmd_actual;
    RobotCommand rob_cmd_expected;

    rob_cmd_expected.desired_speed = 50;

    ext_comm_dec.check_external_command(rob_cmd_actual);

    assert_commands_equal(rob_cmd_expected, rob_cmd_actual);
}

ZTEST(command_decoder, test_check_external_command_angle_BLE_joy)
{
    BLEJoystickDecoder in_parser;
    char in_data[] = { 'B', 'b', '\0' }; // Command to decrease servo angle in BLE Joystick format
    SimulatedUART sim_uart(in_data, sizeof(in_data) / sizeof(char));
    ExternalCommandDecoder ext_comm_dec(sim_uart, in_parser);

    RobotCommand rob_cmd_actual;
    RobotCommand rob_cmd_expected;

    rob_cmd_expected.desired_servo_angle = 70;

    ext_comm_dec.check_external_command(rob_cmd_actual);

    assert_commands_equal(rob_cmd_expected, rob_cmd_actual);
}

ZTEST_SUITE(command_decoder, NULL, NULL, NULL, NULL, NULL);
```

## src/test_filter.cpp
```c
#include "ExpFilter.h"

#include <zephyr/ztest.h>

namespace {

// Overloads select the right comparison for each filter value type.
void assert_filter_output(int expected, int actual)
{
    zassert_equal(actual, expected);
}

void assert_filter_output(float expected, float actual)
{
    // Same tolerance as Unity's TEST_ASSERT_EQUAL_FLOAT, which v1's test used:
    // a relative delta of expected * 0.00001.
    float delta = expected * 0.00001f;
    zassert_within(actual, expected, delta < 0 ? -delta : delta);
}

template <int N, typename T>
void test_step(const T input[], const T expected[], unsigned len)
{
    ExpFilter<T, N> filter;
    for (unsigned i = 0; i < len; i++) {
        auto out = filter.next(input[i]);

        assert_filter_output(expected[i], out);
    }
}

} // namespace

ZTEST(filter, test_step_N_4_int)
{
    constexpr int FILTER_N = 4;
    const int input[] = { 0, 0, 0, 0, 100, 100, 100, 100, 100, 100, 100, 100, 100, 100, 100, 100, 100, 100, 100 };
    const int expected[] = { 0, 0, 0, 0, 25, 43, 57, 67, 75, 81, 85, 88, 91, 93, 94, 95, 96, 97, 97 };

    test_step<FILTER_N>(input, expected, ARRAY_SIZE(input));
}

ZTEST(filter, test_step_N_4_float)
{
    constexpr int FILTER_N = 4;
    const float input[] = { 0, 0, 0, 0, 100, 100, 100, 100, 100, 100, 100, 100, 100, 100, 100, 100, 100, 100, 100 };
    const float expected[] = { 0, 0, 0, 0, 25, 43.75, 57.8125, 68.359375, 76.26953125, 82.2021484375,
        86.651611328125, 89.9887084960938, 92.4915313720703, 94.3686485290527, 95.7764863967896, 96.8323647975922,
        97.6242735981941, 98.2182051986456, 98.6636538989842 };

    test_step<FILTER_N>(input, expected, ARRAY_SIZE(input));
}

ZTEST(filter, test_step_N_10_int)
{
    constexpr int FILTER_N = 10;
    const int input[] = { 0, 0, 0, 0, 100, 100, 100, 100, 100, 100, 100, 100, 100, 100, 100, 100, 100, 100, 100 };
    const int expected[] = { 0, 0, 0, 0, 10, 19, 27, 34, 40, 46, 51, 55, 59, 63, 66, 69, 72, 74, 76 };

    test_step<FILTER_N>(input, expected, ARRAY_SIZE(input));
}

ZTEST(filter, test_step_N_10_float)
{
    constexpr int FILTER_N = 10;
    const float input[] = { 0, 0, 0, 0, 100, 100, 100, 100, 100, 100, 100, 100, 100, 100, 100, 100, 100, 100, 100 };
    const float expected[] = { 0, 0, 0, 0, 10, 19, 27.1, 34.39, 40.951, 46.8559, 52.17031, 56.953279, 61.2579511,
        65.13215599, 68.618940391, 71.7570463519, 74.58134171671, 77.123207545039, 79.4108867905351 };

    test_step<FILTER_N>(input, expected, ARRAY_SIZE(input));
}

ZTEST_SUITE(filter, NULL, NULL, NULL, NULL, NULL);
```

## src/test_pi_controller.cpp
```c
#include "PiController.h"

#include <zephyr/ztest.h>

namespace {
const float PERIOD_S = 0.1f;
const float OUTPUT_MIN = -255.0f;
const float OUTPUT_MAX = 255.0f;
const float TOLERANCE = 1e-4f;
} // namespace

// zassert_within() evaluates its first argument twice, so each update() result
// is stored before it is checked.

ZTEST(pi_controller, test_zero_error_gives_zero_output)
{
    float out = 0.0f;
    PiController controller(2.0f, 5.0f, PERIOD_S, OUTPUT_MIN, OUTPUT_MAX);

    out = controller.update(100.0f, 100.0f);

    zassert_within(out, 0.0f, TOLERANCE);
}

ZTEST(pi_controller, test_proportional_term)
{
    float out = 0.0f;
    const float KP = 0.5f;
    PiController controller(KP, 0.0f, PERIOD_S, OUTPUT_MIN, OUTPUT_MAX);

    out = controller.update(100.0f, 60.0f);

    zassert_within(out, KP * 40.0f, TOLERANCE);
    out = controller.update(100.0f, 140.0f);
    zassert_within(out, KP * -40.0f, TOLERANCE);
}

ZTEST(pi_controller, test_integral_term_accumulates_per_period)
{
    float out = 0.0f;
    const float KI = 2.0f;
    const float ERROR = 10.0f;
    PiController controller(0.0f, KI, PERIOD_S, OUTPUT_MIN, OUTPUT_MAX);

    out = controller.update(ERROR, 0.0f);

    zassert_within(out, KI * ERROR * PERIOD_S, TOLERANCE);
    out = controller.update(ERROR, 0.0f);
    zassert_within(out, 2 * KI * ERROR * PERIOD_S, TOLERANCE);
    out = controller.update(ERROR, 0.0f);
    zassert_within(out, 3 * KI * ERROR * PERIOD_S, TOLERANCE);
}

ZTEST(pi_controller, test_proportional_and_integral_terms_add)
{
    float out = 0.0f;
    const float KP = 0.5f;
    const float KI = 2.0f;
    const float ERROR = 10.0f;
    PiController controller(KP, KI, PERIOD_S, OUTPUT_MIN, OUTPUT_MAX);

    controller.update(ERROR, 0.0f);
    out = controller.update(ERROR, 0.0f);
    zassert_within(out, KP * ERROR + 2 * KI * ERROR * PERIOD_S, TOLERANCE);
}

ZTEST(pi_controller, test_integral_holds_output_once_error_is_gone)
{
    float out = 0.0f;
    // The point of the integral term: it keeps the output that removed the
    // error, which a P controller alone can't.
    const float KI = 2.0f;
    const float ERROR = 10.0f;
    PiController controller(1.0f, KI, PERIOD_S, OUTPUT_MIN, OUTPUT_MAX);

    controller.update(ERROR, 0.0f);
    controller.update(ERROR, 0.0f);
    out = controller.update(ERROR, ERROR);
    zassert_within(out, 2 * KI * ERROR * PERIOD_S, TOLERANCE);
}

ZTEST(pi_controller, test_output_is_clamped)
{
    float out = 0.0f;
    PiController controller(10.0f, 0.0f, PERIOD_S, OUTPUT_MIN, OUTPUT_MAX);

    out = controller.update(1000.0f, 0.0f);

    zassert_within(out, OUTPUT_MAX, TOLERANCE);
    out = controller.update(-1000.0f, 0.0f);
    zassert_within(out, OUTPUT_MIN, TOLERANCE);
}

ZTEST(pi_controller, test_no_windup_while_saturated_high)
{
    float out = 0.0f;
    // Without anti-windup, 50 periods at +1000 would build an integral of
    // 5000 and keep the output clamped long after the error reverses.
    PiController controller(0.0f, 1.0f, 1.0f, OUTPUT_MIN, OUTPUT_MAX);

    for (int i = 0; i < 50; i++) {
        out = controller.update(1000.0f, 0.0f);
        zassert_within(out, OUTPUT_MAX, TOLERANCE);
    }

    out = controller.update(0.0f, 10.0f);
    zassert_true(out < OUTPUT_MAX, "output must leave the limit at once");
}

ZTEST(pi_controller, test_no_windup_while_saturated_low)
{
    float out = 0.0f;
    PiController controller(0.0f, 1.0f, 1.0f, OUTPUT_MIN, OUTPUT_MAX);

    for (int i = 0; i < 50; i++) {
        out = controller.update(-1000.0f, 0.0f);
        zassert_within(out, OUTPUT_MIN, TOLERANCE);
    }

    out = controller.update(10.0f, 0.0f);
    zassert_true(out > OUTPUT_MIN, "output must leave the limit at once");
}

ZTEST(pi_controller, test_reset_clears_integral)
{
    float out = 0.0f;
    const float KI = 2.0f;
    PiController controller(0.0f, KI, PERIOD_S, OUTPUT_MIN, OUTPUT_MAX);

    controller.update(10.0f, 0.0f);
    controller.reset();
    out = controller.update(0.0f, 0.0f);
    zassert_within(out, 0.0f, TOLERANCE);
}

ZTEST_SUITE(pi_controller, NULL, NULL, NULL, NULL, NULL);
```

## src/test_regulator.cpp
```c
#include "Regulator.h"

#include <zephyr/ztest.h>

namespace {
const int SETPOINT_CM = 25;
const int INSENSITIVITY_CM = 2;
const int ACTION_LIMIT_UP = 45;
const int ACTION_LIMIT_BOTTOM = -30;
} // namespace

ZTEST(regulator, test_p_regulator_within_insensitivity_band_is_zero)
{
    const int GAIN = 5;
    Regulator_P<int> regulator(GAIN, SETPOINT_CM, INSENSITIVITY_CM, ACTION_LIMIT_UP, ACTION_LIMIT_BOTTOM);

    zassert_equal(regulator.action(SETPOINT_CM - 1), 0); // e = 1, within insensitivity
}

ZTEST(regulator, test_p_regulator_applies_gain)
{
    const int GAIN = 5;
    const int ERROR_CM = 5;
    Regulator_P<int> regulator(GAIN, SETPOINT_CM, INSENSITIVITY_CM, ACTION_LIMIT_UP, ACTION_LIMIT_BOTTOM);

    zassert_equal(regulator.action(SETPOINT_CM - ERROR_CM), GAIN * ERROR_CM);
}

ZTEST(regulator, test_p_regulator_clamps_to_upper_limit)
{
    const int GAIN = 10;
    Regulator_P<int> regulator(GAIN, SETPOINT_CM, INSENSITIVITY_CM, ACTION_LIMIT_UP, ACTION_LIMIT_BOTTOM);

    zassert_equal(regulator.action(0), ACTION_LIMIT_UP); // e = 25, raw out = 250
}

ZTEST(regulator, test_p_regulator_clamps_to_lower_limit)
{
    const int GAIN = 10;
    Regulator_P<int> regulator(GAIN, SETPOINT_CM, INSENSITIVITY_CM, ACTION_LIMIT_UP, ACTION_LIMIT_BOTTOM);

    zassert_equal(regulator.action(50), ACTION_LIMIT_BOTTOM); // e = -25, raw out = -250
}

ZTEST(regulator, test_p_regulator_clamps_to_custom_action_limits)
{
    const int GAIN = 10;
    // Deliberately different from ACTION_LIMIT_UP/ACTION_LIMIT_BOTTOM above, to
    // prove the limits are actually per-instance rather than hardcoded.
    const int CUSTOM_ACTION_LIMIT_UP = 20;
    const int CUSTOM_ACTION_LIMIT_BOTTOM = -15;
    Regulator_P<int> regulator(
        GAIN, SETPOINT_CM, INSENSITIVITY_CM, CUSTOM_ACTION_LIMIT_UP, CUSTOM_ACTION_LIMIT_BOTTOM);

    zassert_equal(regulator.action(0), CUSTOM_ACTION_LIMIT_UP); // e = 25, raw out = 250
    zassert_equal(regulator.action(50), CUSTOM_ACTION_LIMIT_BOTTOM); // e = -25, raw out = -250
}

ZTEST(regulator, test_pd_regulator_first_action_ignores_derivative)
{
    const int GAIN = 2;
    const int D_GAIN = 3;
    const int ERROR_CM = 5;
    Regulator_PD<int> regulator(GAIN, D_GAIN, SETPOINT_CM, INSENSITIVITY_CM, ACTION_LIMIT_UP, ACTION_LIMIT_BOTTOM);

    zassert_equal(regulator.action(SETPOINT_CM - ERROR_CM), GAIN * ERROR_CM);
}

ZTEST(regulator, test_pd_regulator_adds_derivative_term_on_subsequent_action)
{
    const int GAIN = 2;
    const int D_GAIN = 3;
    const int FIRST_ERROR_CM = 5;
    const int SECOND_ERROR_CM = 10;
    Regulator_PD<int> regulator(GAIN, D_GAIN, SETPOINT_CM, INSENSITIVITY_CM, ACTION_LIMIT_UP, ACTION_LIMIT_BOTTOM);

    regulator.action(SETPOINT_CM - FIRST_ERROR_CM); // primes derivative state (last_e = FIRST_ERROR_CM)
    zassert_equal(regulator.action(SETPOINT_CM - SECOND_ERROR_CM),
        GAIN * SECOND_ERROR_CM + (SECOND_ERROR_CM - FIRST_ERROR_CM) * D_GAIN);
}

ZTEST(regulator, test_pd_regulator_keeps_last_error_across_insensitivity_band)
{
    const int GAIN = 1;
    const int D_GAIN = 1;
    const int FIRST_ERROR_CM = 5;
    const int THIRD_ERROR_CM = 6;
    Regulator_PD<int> regulator(GAIN, D_GAIN, SETPOINT_CM, INSENSITIVITY_CM, ACTION_LIMIT_UP, ACTION_LIMIT_BOTTOM);

    regulator.action(SETPOINT_CM - FIRST_ERROR_CM); // primes derivative state (last_e = FIRST_ERROR_CM)
    regulator.action(SETPOINT_CM); // e = 0, inside insensitivity band, derivative state left untouched
    // derivative term uses the stale last_e (FIRST_ERROR_CM) rather than the
    // skipped e (0)
    zassert_equal(regulator.action(SETPOINT_CM - THIRD_ERROR_CM),
        GAIN * THIRD_ERROR_CM + (THIRD_ERROR_CM - FIRST_ERROR_CM) * D_GAIN);
}

ZTEST_SUITE(regulator, NULL, NULL, NULL, NULL, NULL);
```

## src/test_robot.cpp
```c
#include "MotionConstants.h"
#include "OvladackaParser.h"
#include "Robot.h"
#include "RobotPrinter.h"
#include "simulated_uart.h"

#include <zephyr/ztest.h>

namespace {

class StubDistanceSensor : public IDistanceSensor {
public:
    unsigned long raw_cm = 100;
    unsigned long filtered_cm = 100;
    int raw_calls = 0;
    int filtered_calls = 0;

    bool trigger_measurement() override { return true; }
    unsigned long get_distance_raw_cm() override
    {
        raw_calls++;
        return raw_cm;
    }
    unsigned long get_distance_filtered_cm() override
    {
        filtered_calls++;
        return filtered_cm;
    }
};

class StubBatterySensor : public IBatterySensor {
public:
    uint16_t voltage_mVDC = 0;
    uint16_t get_battery_voltage_adc() override { return 0; }
    uint16_t get_battery_voltage_mVDC() override { return voltage_mVDC; }
};

class StubCurrentSensor : public ICurrentSensor {
public:
    uint16_t current_mA = 0;
    uint16_t get_current_mA() override { return current_mA; }
};

class StubMotorController : public IMotorController {
public:
    int last_speed = 0;
    int set_speed_calls = 0;

    bool set_speed(int speed) override
    {
        last_speed = speed;
        set_speed_calls++;
        return true;
    }
    void stop() override { }
};

class StubSteeringServo : public ISteeringServo {
public:
    int last_angle = 0;
    int set_angle_calls = 0;

    bool set_angle(int angle) override
    {
        last_angle = angle;
        set_angle_calls++;
        return true;
    }
};

class StubRobotIndicators : public IRobotIndicators {
public:
    RobotIndicatorState last_state = RobotIndicatorState::IDLE;
    int indicate_robot_state_calls = 0;
    int indicate_battery_warning_calls = 0;

    int indicate_robot_state(RobotIndicatorState state) override
    {
        last_state = state;
        indicate_robot_state_calls++;
        return 0;
    }
    int indicate_battery_warning() override
    {
        indicate_battery_warning_calls++;
        return 0;
    }
};

// Pass-through regulator/filter stand-ins, same as test_auto_steering.cpp, so
// AutoSteering's output is deterministic and easy to predict here.
class IdentityRegulator : public Regulator<int> {
protected:
    int regulator_equation(int e) override { return e; }

public:
    // Action limits mirror Regulator's old hardcoded defaults - irrelevant to
    // what this test double is standing in for here.
    IdentityRegulator()
        : Regulator<int>(1, 0, 0, 45, -30)
    {
    }
};

class IdentityFilter : public IFilter<int> {
public:
    int next(int input) override { return input; }
};

const int SIDE_DISTANCE_SETPOINT_CM = 25;
const int TURNING_RADIUS_CM = 15;
const int AVOIDING_DISTANCE_THR_CM = SIDE_DISTANCE_SETPOINT_CM + TURNING_RADIUS_CM;
const int FAR_DISTANCE_CM = 100; // clearly outside any threshold used below
const uint16_t BATTERY_CUTOFF_mVDC = 450;
const uint16_t BATTERY_HYSTERESIS_mVDC = 50;

} // namespace

ZTEST(robot, test_perform_status_check_battery_ok_does_not_warn)
{
    StubDistanceSensor front_sensor, right_front_sensor, right_center_sensor;
    DistanceSensors distance_sensors { front_sensor, right_front_sensor,
        right_center_sensor };
    SimulatedUART sensing_stream;
    RobotPrinter sensing_printer(sensing_stream);
    Sensing robot_sensing(distance_sensors, sensing_printer);

    StubBatterySensor battery_sensor;
    StubCurrentSensor current_sensor;
    battery_sensor.voltage_mVDC = BATTERY_CUTOFF_mVDC + 1;
    SimulatedUART battery_stream;
    RobotPrinter battery_printer(battery_stream);
    Battery robot_battery(battery_sensor, current_sensor, battery_printer,
        BATTERY_CUTOFF_mVDC, BATTERY_HYSTERESIS_mVDC);

    StubMotorController motor;
    StubSteeringServo servo;
    Motion robot_motion(motor, servo);

    IdentityRegulator regulator;
    IdentityFilter filter;
    AutoSteering<int> wall_following_steering(SIDE_DISTANCE_SETPOINT_CM,
        regulator, filter);

    SimulatedUART command_stream;
    OvladackaParser command_parser;
    ExternalCommandDecoder external_command_decoder(command_stream,
        command_parser);

    StubRobotIndicators indicators;

    Robot robot(robot_sensing, robot_battery, robot_motion,
        wall_following_steering, external_command_decoder, indicators);

    robot.perform_status_check(0);

    zassert_equal(indicators.indicate_battery_warning_calls, 0);
}

ZTEST(robot, test_perform_status_check_battery_dead_disables_motion_and_sensing)
{
    StubDistanceSensor front_sensor, right_front_sensor, right_center_sensor;
    DistanceSensors distance_sensors { front_sensor, right_front_sensor,
        right_center_sensor };
    SimulatedUART sensing_stream;
    RobotPrinter sensing_printer(sensing_stream);
    Sensing robot_sensing(distance_sensors, sensing_printer);

    StubBatterySensor battery_sensor;
    StubCurrentSensor current_sensor;
    battery_sensor.voltage_mVDC = BATTERY_CUTOFF_mVDC - 1;
    SimulatedUART battery_stream;
    RobotPrinter battery_printer(battery_stream);
    Battery robot_battery(battery_sensor, current_sensor, battery_printer,
        BATTERY_CUTOFF_mVDC, BATTERY_HYSTERESIS_mVDC);

    StubMotorController motor;
    StubSteeringServo servo;
    Motion robot_motion(motor, servo);

    IdentityRegulator regulator;
    IdentityFilter filter;
    AutoSteering<int> wall_following_steering(SIDE_DISTANCE_SETPOINT_CM,
        regulator, filter);

    SimulatedUART command_stream;
    OvladackaParser command_parser;
    ExternalCommandDecoder external_command_decoder(command_stream,
        command_parser);

    StubRobotIndicators indicators;

    Robot robot(robot_sensing, robot_battery, robot_motion,
        wall_following_steering, external_command_decoder, indicators);

    robot.perform_status_check(0);
    zassert_equal(indicators.indicate_battery_warning_calls, 1);

    // Sensing should now be disabled: distance sensors must not be touched.
    robot.perform_automatic_action(0);
    zassert_equal(front_sensor.filtered_calls, 0);
    zassert_equal(right_front_sensor.raw_calls, 0);
    zassert_equal(right_center_sensor.raw_calls, 0);

    // Motion should now be disabled: motor/servo must not be commanded.
    robot.apply_motion_command();
    zassert_equal(motor.set_speed_calls, 0);
    zassert_equal(servo.set_angle_calls, 0);
}

ZTEST(robot, test_perform_automatic_action_updates_command_when_automatic)
{
    StubDistanceSensor front_sensor, right_front_sensor, right_center_sensor;
    front_sensor.filtered_cm = FAR_DISTANCE_CM;
    // IdentityRegulator's setpoint is 0 (see its constructor below), so a
    // right distance (the min of right_front/right_center) of 0 is what makes
    // it - and the identity filter - yield a zero steering correction, i.e. a
    // centered servo. right_front is kept far away on its own so it doesn't
    // separately trip AutoSteering's close-obstacle AVOIDING threshold.
    right_front_sensor.raw_cm = FAR_DISTANCE_CM;
    right_center_sensor.raw_cm = 0;
    DistanceSensors distance_sensors { front_sensor, right_front_sensor,
        right_center_sensor };
    SimulatedUART sensing_stream;
    RobotPrinter sensing_printer(sensing_stream);
    Sensing robot_sensing(distance_sensors, sensing_printer);

    StubBatterySensor battery_sensor;
    StubCurrentSensor current_sensor;
    battery_sensor.voltage_mVDC = BATTERY_CUTOFF_mVDC + 1;
    SimulatedUART battery_stream;
    RobotPrinter battery_printer(battery_stream);
    Battery robot_battery(battery_sensor, current_sensor, battery_printer,
        BATTERY_CUTOFF_mVDC, BATTERY_HYSTERESIS_mVDC);

    StubMotorController motor;
    StubSteeringServo servo;
    Motion robot_motion(motor, servo);

    IdentityRegulator regulator;
    IdentityFilter filter;
    AutoSteering<int> wall_following_steering(SIDE_DISTANCE_SETPOINT_CM,
        regulator, filter);

    SimulatedUART command_stream;
    OvladackaParser command_parser;
    ExternalCommandDecoder external_command_decoder(command_stream,
        command_parser);

    StubRobotIndicators indicators;

    // Robot starts in AUTOMATIC by default, no external command needed.
    Robot robot(robot_sensing, robot_battery, robot_motion,
        wall_following_steering, external_command_decoder, indicators);

    robot.perform_automatic_action(0);
    robot.apply_motion_command();

    // Right distance sits exactly at the setpoint, so the identity
    // regulator/filter both yield zero and the servo stays centered.
    zassert_equal(servo.last_angle, SERVO_CENTER);
    zassert_equal(static_cast<int>(indicators.last_state), static_cast<int>(RobotIndicatorState::MOVING_FOLLOWING));
}

ZTEST(robot, test_perform_automatic_action_ignored_when_manual)
{
    StubDistanceSensor front_sensor, right_front_sensor, right_center_sensor;
    // Close enough to trigger AVOIDING (and a servo angle far from center) if
    // automatic steering were mistakenly still applied.
    front_sensor.filtered_cm = AVOIDING_DISTANCE_THR_CM - 1;
    right_front_sensor.raw_cm = SIDE_DISTANCE_SETPOINT_CM;
    right_center_sensor.raw_cm = SIDE_DISTANCE_SETPOINT_CM;
    DistanceSensors distance_sensors { front_sensor, right_front_sensor,
        right_center_sensor };
    SimulatedUART sensing_stream;
    RobotPrinter sensing_printer(sensing_stream);
    Sensing robot_sensing(distance_sensors, sensing_printer);

    StubBatterySensor battery_sensor;
    StubCurrentSensor current_sensor;
    battery_sensor.voltage_mVDC = BATTERY_CUTOFF_mVDC + 1;
    SimulatedUART battery_stream;
    RobotPrinter battery_printer(battery_stream);
    Battery robot_battery(battery_sensor, current_sensor, battery_printer,
        BATTERY_CUTOFF_mVDC, BATTERY_HYSTERESIS_mVDC);

    StubMotorController motor;
    StubSteeringServo servo;
    Motion robot_motion(motor, servo);

    IdentityRegulator regulator;
    IdentityFilter filter;
    AutoSteering<int> wall_following_steering(SIDE_DISTANCE_SETPOINT_CM,
        regulator, filter);

    // ':f!' is the RIGHT_CIRCLE command, which toggles automatic operation off.
    char in_data[] = ":f!";
    SimulatedUART command_stream(in_data, sizeof(in_data) / sizeof(char));
    OvladackaParser command_parser;
    ExternalCommandDecoder external_command_decoder(command_stream,
        command_parser);

    StubRobotIndicators indicators;

    Robot robot(robot_sensing, robot_battery, robot_motion,
        wall_following_steering, external_command_decoder, indicators);

    robot.check_external_command(); // switches to MANUAL
    robot.perform_automatic_action(0);
    robot.apply_motion_command();

    // In MANUAL, perform_automatic_action must neither update the desired
    // servo angle (still the RobotCommand default) nor drive the indicators.
    zassert_equal(servo.last_angle, SERVO_CENTER);
    zassert_equal(indicators.indicate_robot_state_calls, 0);
}

ZTEST(robot, test_check_external_command_speed_applies_through_motion)
{
    StubDistanceSensor front_sensor, right_front_sensor, right_center_sensor;
    DistanceSensors distance_sensors { front_sensor, right_front_sensor,
        right_center_sensor };
    SimulatedUART sensing_stream;
    RobotPrinter sensing_printer(sensing_stream);
    Sensing robot_sensing(distance_sensors, sensing_printer);

    StubBatterySensor battery_sensor;
    StubCurrentSensor current_sensor;
    battery_sensor.voltage_mVDC = BATTERY_CUTOFF_mVDC + 1;
    SimulatedUART battery_stream;
    RobotPrinter battery_printer(battery_stream);
    Battery robot_battery(battery_sensor, current_sensor, battery_printer,
        BATTERY_CUTOFF_mVDC, BATTERY_HYSTERESIS_mVDC);

    StubMotorController motor;
    StubSteeringServo servo;
    Motion robot_motion(motor, servo);

    IdentityRegulator regulator;
    IdentityFilter filter;
    AutoSteering<int> wall_following_steering(SIDE_DISTANCE_SETPOINT_CM,
        regulator, filter);

    // ':a!' is the UP command, which increases desired speed.
    char in_data[] = ":a!";
    SimulatedUART command_stream(in_data, sizeof(in_data) / sizeof(char));
    OvladackaParser command_parser;
    ExternalCommandDecoder external_command_decoder(command_stream,
        command_parser);

    StubRobotIndicators indicators;

    Robot robot(robot_sensing, robot_battery, robot_motion,
        wall_following_steering, external_command_decoder, indicators);

    robot.check_external_command();
    robot.apply_motion_command();

    zassert_equal(motor.last_speed, SPEED_INCREMENT);
    zassert_equal(motor.set_speed_calls, 1);
}

ZTEST_SUITE(robot, NULL, NULL, NULL, NULL, NULL);
```

## src/test_robot_packets.cpp
```c
#include "RobotPackets.h"
#include "RobotPrinter.h"
#include "simulated_uart.h"

#include <zephyr/ztest.h>

ZTEST(robot_packets, test_status_packet)
{
    const int CURRENT_TICK = 1000;
    const int BATTERY_VOLTAGE = 100;
    const int TOTAL_CURRENT = 0;
    const int MOTOR_CURRENT = 0;
    StatusPacket status_packet(CURRENT_TICK, BATTERY_VOLTAGE, TOTAL_CURRENT, MOTOR_CURRENT);
    status_packet.version_ID = 0xAB;
    // Little endian on the wire, i.e. LSB goes first
    uint8_t expected[] = {
        0x50, // id
        0xE8, 0x03, 0x00, 0x00, // tick
        0xAB, 0x00, 0x00, 0x00, // version ID
        0x64, 0x00, // battery voltage
        0x00, 0x00, // total current
        0x00, 0x00, // motor current
        0x74 // CRC
    };

    SimulatedUART sim_uart;
    RobotPrinter printer(sim_uart);

    printer.print(status_packet);

    uint8_t actual[sizeof(expected)];
    for (unsigned i = 0; i < sizeof(expected); i++) {
        actual[i] = sim_uart.read();
    }

    zassert_mem_equal(actual, expected, sizeof(expected));
}

ZTEST(robot_packets, test_sonar_packet)
{
    const int PACKET_ID = 101;
    const unsigned long CURRENT_TICK = 1000;
    const unsigned long MEASUREMENT = 0xdeadbeef;

    SonarPacket sonar_packet(PACKET_ID, CURRENT_TICK, MEASUREMENT);
    // Little endian on the wire, i.e. LSB goes first
    uint8_t expected[] = {
        0x65, // id
        0xE8, 0x03, 0x00, 0x00, // tick
        0xEF, 0xBE, 0xAD, 0xDE, // measurement
        0xAC // CRC
    };

    SimulatedUART sim_uart;
    RobotPrinter printer(sim_uart);

    printer.print(sonar_packet);

    uint8_t actual[sizeof(expected)];
    for (unsigned i = 0; i < sizeof(expected); i++) {
        actual[i] = sim_uart.read();
    }

    zassert_mem_equal(actual, expected, sizeof(expected));
}

ZTEST_SUITE(robot_packets, NULL, NULL, NULL, NULL, NULL);
```
