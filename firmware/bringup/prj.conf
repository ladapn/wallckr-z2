## CMakeLists.txt
```
# wallckr-z2 hardware bring-up firmware.
#   west build -b nucleo_f401re --shield motherboard_shield \
#     --shield x_nucleo_bnrg2a1 --shield buttonled_shield firmware/bringup

cmake_minimum_required(VERSION 3.20.0)

find_package(Zephyr REQUIRED HINTS $ENV{ZEPHYR_BASE})
project(wallckr_bringup LANGUAGES CXX)

target_sources(app PRIVATE
    src/main.cpp
    src/analog.cpp
    src/ble.cpp
    src/buttons.cpp
    src/encoder.cpp
    src/leds.cpp
    src/motor.cpp
    src/servo.cpp
    src/ultrasonic.cpp
)

# The minimal C++ library has no STL headers; ETL must not reach for them.
target_compile_definitions(app PRIVATE ETL_NO_STL)
```

## prj.conf
```kconfig
# Language: C++23 on the minimal C++ library, no exceptions/RTTI.
CONFIG_CPP=y
CONFIG_STD_CPP23=y
CONFIG_MINIMAL_LIBCPP=y
CONFIG_CPP_EXCEPTIONS=n
CONFIG_CPP_RTTI=n
# Containers/utilities in place of the STL the minimal library lacks.
CONFIG_ETL=y

# Bring-up is driven interactively from the ST-LINK virtual COM port.
CONFIG_SHELL=y
CONFIG_LOG=y

# Peripherals exercised by the bring-up commands.
CONFIG_GPIO=y
CONFIG_PWM=y
CONFIG_ADC=y
CONFIG_SENSOR=y

# Bring-up reads the battery / current ADC channels raw, to show both the
# pin voltage and the scaled value; the upstream drivers are not needed.
CONFIG_VOLTAGE_DIVIDER=n
CONFIG_CURRENT_AMP=n

# BLE link test: a Nordic UART Service peripheral (see src/ble.cpp).
CONFIG_BT=y
CONFIG_BT_PERIPHERAL=y
CONFIG_BT_ZEPHYR_NUS=y
CONFIG_BT_DEVICE_NAME="wallckr-bringup"
CONFIG_BT_HCI_ERR_TO_STR=y
```

## src/main.cpp
```c
#include "bringup.h"

#include <etl/array.h>
#include <zephyr/logging/log.h>

LOG_MODULE_REGISTER(bringup, LOG_LEVEL_INF);

namespace {

struct Module {
    const char* name;
    int (*init)();
};

constexpr etl::array modules {
    Module { .name = "leds", .init = leds_init },
    Module { .name = "motor", .init = motor_init },
    Module { .name = "servo", .init = servo_init },
    Module { .name = "ultrasonic", .init = ultrasonic_init },
    Module { .name = "analog", .init = analog_init },
    Module { .name = "encoder", .init = encoder_init },
    Module { .name = "ble", .init = ble_init },
};

} // namespace

int main()
{
    LOG_INF("wallckr-z2 bring-up firmware");

    int failures = 0;
    for (const auto& module : modules) {
        if (int ret = module.init()) {
            LOG_ERR("%s: init failed (%d)", module.name, ret);
            failures++;
        }
    }

    leds_self_test();

    if (failures) {
        LOG_ERR("%d module(s) failed to initialise", failures);
    }
    LOG_INF("Ready, type 'help' for the bring-up commands");
    return 0;
}
```

## src/analog.cpp
```c
#include "bringup.h"

#include <etl/array.h>
#include <zephyr/drivers/adc.h>
#include <zephyr/shell/shell.h>

namespace {

#define BATTERY_NODE DT_NODELABEL(battery_voltage)
#define CURRENT_NODE DT_NODELABEL(supply_current)

const adc_dt_spec battery = ADC_DT_SPEC_GET(BATTERY_NODE);
const adc_dt_spec current = ADC_DT_SPEC_GET(CURRENT_NODE);

struct Reading {
    int32_t raw;
    int32_t pin_mv;
};

int read(const adc_dt_spec& channel, Reading& reading)
{
    int16_t sample;
    adc_sequence sequence = {
        .buffer = &sample,
        .buffer_size = sizeof(sample),
    };

    if (int ret = adc_sequence_init_dt(&channel, &sequence)) {
        return ret;
    }
    if (int ret = adc_read_dt(&channel, &sequence)) {
        return ret;
    }

    reading.raw = sample;
    reading.pin_mv = sample;
    return adc_raw_to_millivolts_dt(&channel, &reading.pin_mv);
}

int32_t battery_mv(int32_t pin_mv)
{
    return static_cast<int32_t>(
        int64_t { pin_mv } * DT_PROP(BATTERY_NODE, full_ohms) / DT_PROP(BATTERY_NODE, output_ohms));
}

int32_t current_ma(int32_t pin_mv)
{
    // I = V / (Rsense * gain), with Rsense in milliohms.
    return static_cast<int32_t>(int64_t { pin_mv } * 1000 * DT_PROP(CURRENT_NODE, sense_gain_div)
        / (int64_t { DT_PROP(CURRENT_NODE, sense_resistor_milli_ohms) } * DT_PROP(CURRENT_NODE, sense_gain_mult)));
}

int cmd_analog(const shell* sh, size_t, char**)
{
    Reading reading;

    if (int ret = read(battery, reading)) {
        shell_error(sh, "Battery voltage read failed (%d)", ret);
        return ret;
    }
    shell_print(sh, "battery: %d mV (raw %d, pin %d mV)", battery_mv(reading.pin_mv), reading.raw,
        reading.pin_mv);

    if (int ret = read(current, reading)) {
        shell_error(sh, "Current read failed (%d)", ret);
        return ret;
    }
    shell_print(sh, "current: %d mA (raw %d, pin %d mV)", current_ma(reading.pin_mv), reading.raw,
        reading.pin_mv);
    return 0;
}

} // namespace

int analog_init()
{
    for (const auto* channel : etl::array { &battery, &current }) {
        if (!adc_is_ready_dt(channel)) {
            return -ENODEV;
        }
        if (int ret = adc_channel_setup_dt(channel)) {
            return ret;
        }
    }
    return 0;
}

SHELL_CMD_REGISTER(analog, NULL, "Read battery voltage and total supply current", cmd_analog);
```

## src/ble.cpp
```c
// BLE link test, based on Zephyr's peripheral_nus sample: advertise the
// Nordic UART Service, send a numbered heartbeat every second once a phone
// subscribes, and log whatever it writes. Disconnects are logged with
// the HCI reason (e.g. supervision timeout), so link drops while the motor
// runs show up on the console as well as in the phone's heartbeat stream.

#include "bringup.h"

#include <etl/array.h>
#include <etl/string.h>
#include <etl/to_string.h>
#include <zephyr/bluetooth/bluetooth.h>
#include <zephyr/bluetooth/conn.h>
#include <zephyr/bluetooth/hci.h>
#include <zephyr/bluetooth/services/nus.h>
#include <zephyr/kernel.h>
#include <zephyr/logging/log.h>
#include <zephyr/shell/shell.h>

LOG_MODULE_DECLARE(bringup);

namespace {

constexpr int heartbeat_period_ms = 1000;

const etl::array<bt_data, 2> advertising_data {
    bt_data BT_DATA_BYTES(BT_DATA_FLAGS, (BT_LE_AD_GENERAL | BT_LE_AD_NO_BREDR)),
    bt_data BT_DATA(BT_DATA_NAME_COMPLETE, CONFIG_BT_DEVICE_NAME, sizeof(CONFIG_BT_DEVICE_NAME) - 1),
};

const etl::array<bt_data, 1> scan_response_data {
    bt_data BT_DATA_BYTES(BT_DATA_UUID128_ALL, BT_UUID_NUS_SRV_VAL),
};

struct LinkState {
    bt_conn* connection;
    int64_t connected_at_ms;
    uint32_t connections;
    uint32_t disconnects;
    uint8_t last_disconnect_reason;
    bool notifications_enabled;
    uint32_t heartbeats_sent;
    uint32_t heartbeat_errors;
    uint32_t bytes_received;
};

LinkState link;

void start_advertising(k_work*)
{
    if (int ret = bt_le_adv_start(BT_LE_ADV_CONN_FAST_1, advertising_data.data(), advertising_data.size(),
            scan_response_data.data(), scan_response_data.size())) {
        LOG_ERR("BLE: advertising failed to start (%d)", ret);
        return;
    }
    LOG_INF("BLE: advertising as \"%s\"", CONFIG_BT_DEVICE_NAME);
}

K_WORK_DEFINE(advertising_work, start_advertising);

void send_heartbeat(k_work* work)
{
    if (link.notifications_enabled) {
        etl::string<20> message { "tick " };
        etl::to_string(link.heartbeats_sent + 1, message, true);
        message += '\n';
        // nullptr: notify every subscriber, so no connection pointer is shared
        // with the Bluetooth thread that handles disconnects.
        if (bt_nus_send(nullptr, message.data(), message.size())) {
            link.heartbeat_errors++;
        } else {
            link.heartbeats_sent++;
        }
    }
    k_work_schedule(k_work_delayable_from_work(work), K_MSEC(heartbeat_period_ms));
}

K_WORK_DELAYABLE_DEFINE(heartbeat_work, send_heartbeat);

void on_connected(bt_conn* connection, uint8_t error)
{
    if (error) {
        LOG_WRN("BLE: connection failed: %s (0x%02x)", bt_hci_err_to_str(error), error);
        return;
    }
    link.connection = bt_conn_ref(connection);
    link.connected_at_ms = k_uptime_get();
    link.connections++;
    LOG_INF("BLE: connected");
}

void on_disconnected(bt_conn*, uint8_t reason)
{
    link.disconnects++;
    link.last_disconnect_reason = reason;
    link.notifications_enabled = false;
    if (link.connection) {
        bt_conn_unref(link.connection);
        link.connection = nullptr;
    }
    LOG_WRN("BLE: disconnected after %lld s: %s (0x%02x)", (k_uptime_get() - link.connected_at_ms) / 1000,
        bt_hci_err_to_str(reason), reason);
}

// Advertising stops on connection; restart it once the connection object is
// free again, as the Zephyr samples do.
void on_recycled()
{
    k_work_submit(&advertising_work);
}

BT_CONN_CB_DEFINE(connection_callbacks) = {
    .connected = on_connected,
    .disconnected = on_disconnected,
    .recycled = on_recycled,
};

void on_notifications_changed(bool enabled, void*)
{
    link.notifications_enabled = enabled;
    LOG_INF("BLE: heartbeat %s", enabled ? "started" : "stopped");
}

void on_received(bt_conn*, const void* data, uint16_t length, void*)
{
    link.bytes_received += length;
    LOG_INF("BLE: received \"%.*s\"", length, static_cast<const char*>(data));
}

bt_nus_cb nus_callbacks = {
    .notif_enabled = on_notifications_changed,
    .received = on_received,
};

int cmd_status(const shell* sh, size_t, char**)
{
    if (link.connection) {
        bt_conn_info info;
        bt_conn_get_info(link.connection, &info);
        shell_print(sh, "connected for %lld s, interval %u.%02u ms, latency %u, supervision timeout %u ms",
            (k_uptime_get() - link.connected_at_ms) / 1000, info.le.interval_us / 1000,
            (info.le.interval_us % 1000) / 10, info.le.latency, info.le.timeout * 10U);
    } else {
        shell_print(sh, "not connected (advertising as \"%s\")", CONFIG_BT_DEVICE_NAME);
    }
    shell_print(sh, "connections: %u, disconnects: %u, last reason: %s", link.connections, link.disconnects,
        link.disconnects ? bt_hci_err_to_str(link.last_disconnect_reason) : "-");
    shell_print(sh, "heartbeat: %s, sent %u, send errors %u; bytes received %u",
        link.notifications_enabled ? "on" : "off", link.heartbeats_sent, link.heartbeat_errors, link.bytes_received);
    return 0;
}

} // namespace

int ble_init()
{
    if (int ret = bt_nus_cb_register(&nus_callbacks, nullptr)) {
        return ret;
    }
    if (int ret = bt_enable(nullptr)) {
        return ret;
    }
    k_work_submit(&advertising_work);
    k_work_schedule(&heartbeat_work, K_MSEC(heartbeat_period_ms));
    return 0;
}

SHELL_STATIC_SUBCMD_SET_CREATE(ble_cmds,
    SHELL_CMD(status, NULL, "Show link state, connection parameters and drop statistics", cmd_status),
    SHELL_SUBCMD_SET_END);
SHELL_CMD_REGISTER(ble, &ble_cmds, "BLE link test (Nordic UART Service)", NULL);
```

## src/bringup.h
```c
#pragma once

// Each peripheral module configures its hardware here and registers its
// own shell commands. Return 0 or a negative errno.
int leds_init();
int motor_init();
int servo_init();
int ultrasonic_init();
int analog_init();
int encoder_init();
int ble_init();

void leds_self_test();
```

## src/buttons.cpp
```c
// Buttons are gpio-keys, so the input subsystem debounces them and reports
// press/release events, logged here. No init is needed beyond the driver's.

#include <etl/array.h>
#include <zephyr/drivers/gpio.h>
#include <zephyr/input/input.h>
#include <zephyr/logging/log.h>
#include <zephyr/shell/shell.h>

LOG_MODULE_DECLARE(bringup);

namespace {

struct Button {
    const char* name;
    uint16_t code;
    gpio_dt_spec gpio;
};

#define BUTTON(label, node)                                                \
    Button                                                                 \
    {                                                                      \
        .name = (label), .code = DT_PROP(DT_NODELABEL(node), zephyr_code), \
        .gpio = GPIO_DT_SPEC_GET(DT_NODELABEL(node), gpios)                \
    }

const etl::array buttons {
    BUTTON("Button 1", button1),
    BUTTON("Button 2", button2),
};

void on_input(input_event* event, void*)
{
    if (event->type != INPUT_EV_KEY) {
        return;
    }

    for (const auto& button : buttons) {
        if (button.code == event->code) {
            LOG_INF("%s %s", button.name, event->value ? "pressed" : "released");
        }
    }
}

int cmd_buttons(const shell* sh, size_t, char**)
{
    for (const auto& button : buttons) {
        shell_print(sh, "%s: %s", button.name, gpio_pin_get_dt(&button.gpio) ? "pressed" : "released");
    }
    return 0;
}

} // namespace

INPUT_CALLBACK_DEFINE(DEVICE_DT_GET(DT_PARENT(DT_NODELABEL(button1))), on_input, nullptr);

SHELL_CMD_REGISTER(buttons, NULL, "Show the current button states", cmd_buttons);
```

## src/encoder.cpp
```c
#include "bringup.h"

#include <zephyr/drivers/sensor.h>
#include <zephyr/shell/shell.h>

namespace {

const device* const encoder = DEVICE_DT_GET(DT_NODELABEL(encoder));

int cmd_encoder(const shell* sh, size_t, char**)
{
    if (int ret = sensor_sample_fetch(encoder)) {
        shell_error(sh, "Encoder read failed (%d)", ret);
        return ret;
    }

    sensor_value count;
    sensor_channel_get(encoder, SENSOR_CHAN_ENCODER_COUNT, &count);
    shell_print(sh, "encoder count: %d", count.val1);
    return 0;
}

} // namespace

int encoder_init()
{
    return device_is_ready(encoder) ? 0 : -ENODEV;
}

SHELL_CMD_REGISTER(encoder, NULL, "Read the raw quadrature encoder count", cmd_encoder);
```

## src/leds.cpp
```c
#include "bringup.h"

#include <etl/array.h>
#include <etl/string_view.h>
#include <zephyr/drivers/gpio.h>
#include <zephyr/kernel.h>
#include <zephyr/shell/shell.h>

namespace {

struct Led {
    etl::string_view name;
    gpio_dt_spec gpio;
};

const etl::array leds {
    Led { .name = "state1", .gpio = GPIO_DT_SPEC_GET(DT_NODELABEL(led_state1), gpios) },
    Led { .name = "state2", .gpio = GPIO_DT_SPEC_GET(DT_NODELABEL(led_state2), gpios) },
    Led { .name = "err", .gpio = GPIO_DT_SPEC_GET(DT_NODELABEL(led_err), gpios) },
};

const Led* find_led(const etl::string_view& name)
{
    for (const auto& led : leds) {
        if (led.name == name) {
            return &led;
        }
    }
    return nullptr;
}

int cmd_led(const shell* sh, size_t, char** argv)
{
    const Led* led = find_led(argv[1]);
    if (!led) {
        shell_error(sh, "Unknown LED '%s' (state1, state2, err)", argv[1]);
        return -EINVAL;
    }

    etl::string_view state { argv[2] };
    if (state != "on" && state != "off") {
        shell_error(sh, "Expected on or off");
        return -EINVAL;
    }
    return gpio_pin_set_dt(&led->gpio, state == "on");
}

int cmd_led_test(const shell*, size_t, char**)
{
    leds_self_test();
    return 0;
}

} // namespace

int leds_init()
{
    for (const auto& led : leds) {
        if (!gpio_is_ready_dt(&led.gpio)) {
            return -ENODEV;
        }
        if (int ret = gpio_pin_configure_dt(&led.gpio, GPIO_OUTPUT_INACTIVE)) {
            return ret;
        }
    }
    return 0;
}

void leds_self_test()
{
    for (const auto& led : leds) {
        gpio_pin_set_dt(&led.gpio, 1);
        k_msleep(300);
        gpio_pin_set_dt(&led.gpio, 0);
    }
}

SHELL_CMD_ARG_REGISTER(led, NULL, "Switch a status LED: led <state1|state2|err> <on|off>", cmd_led, 3, 0);
SHELL_CMD_REGISTER(led_test, NULL, "Light each status LED in turn", cmd_led_test);
```

## src/motor.cpp
```c
#include "bringup.h"

#include <etl/array.h>
#include <zephyr/drivers/gpio.h>
#include <zephyr/drivers/pwm.h>
#include <zephyr/drivers/sensor.h>
#include <zephyr/logging/log.h>
#include <zephyr/shell/shell.h>

LOG_MODULE_DECLARE(bringup);

namespace {

// Same speed range as v1's IMotorController::set_speed().
constexpr int max_speed = 255;

const pwm_dt_spec enable = PWM_DT_SPEC_GET(DT_NODELABEL(motor));
const gpio_dt_spec phase = GPIO_DT_SPEC_GET(DT_NODELABEL(motor), ph_gpios);
const gpio_dt_spec fault = GPIO_DT_SPEC_GET(DT_NODELABEL(motor), fault_gpios);

const device* const encoder = DEVICE_DT_GET(DT_NODELABEL(encoder));

// The STM32 qdec driver counts from 0 up to the largest multiple of
// counts-per-revolution that fits TIM4's 16 bits, then wraps.
constexpr int32_t counts_per_revolution = DT_PROP(DT_NODELABEL(encoder), st_counts_per_revolution);
constexpr int32_t encoder_modulus = UINT16_MAX - UINT16_MAX % counts_per_revolution;

// Step-response sampling: one encoder sample per period, up to max_step_ms.
constexpr int step_period_ms = 10;
constexpr int max_step_ms = 5000;
etl::array<int32_t, max_step_ms / step_period_ms + 1> step_counts;

gpio_callback fault_callback;
int current_speed;

int set_speed(int speed)
{
    if (int ret = gpio_pin_set_dt(&phase, speed >= 0)) {
        return ret;
    }

    uint32_t magnitude = speed < 0 ? -speed : speed;
    uint32_t pulse = static_cast<uint64_t>(enable.period) * magnitude / max_speed;
    if (int ret = pwm_set_pulse_dt(&enable, pulse)) {
        return ret;
    }

    current_speed = speed;
    return 0;
}

void on_fault(const device*, gpio_callback*, gpio_port_pins_t)
{
    LOG_WRN("Motor driver reports a fault (nFAULT asserted)");
}

int cmd_speed(const shell* sh, size_t, char** argv)
{
    int err = 0;
    long speed = shell_strtol(argv[1], 10, &err);
    if (err || speed < -max_speed || speed > max_speed) {
        shell_error(sh, "Speed must be in [-%d, %d]", max_speed, max_speed);
        return -EINVAL;
    }
    return set_speed(static_cast<int>(speed));
}

int read_encoder(int32_t& count)
{
    if (int ret = sensor_sample_fetch(encoder)) {
        return ret;
    }
    sensor_value value;
    if (int ret = sensor_channel_get(encoder, SENSOR_CHAN_ENCODER_COUNT, &value)) {
        return ret;
    }
    count = value.val1;
    return 0;
}

// Change between two raw counter values, taking the shorter way round the
// wrap.
int32_t encoder_delta(int32_t from, int32_t to)
{
    int32_t delta = to - from;
    if (delta > encoder_modulus / 2) {
        delta -= encoder_modulus;
    } else if (delta < -encoder_modulus / 2) {
        delta += encoder_modulus;
    }
    return delta;
}

// Applies a duty step and samples the encoder every step_period_ms, then
// stops the motor and prints the samples. Printing waits until the end so the
// UART does not disturb the sampling.
int cmd_step(const shell* sh, size_t, char** argv)
{
    int err = 0;
    long speed = shell_strtol(argv[1], 10, &err);
    long duration_ms = err ? 0 : shell_strtol(argv[2], 10, &err);
    if (err || speed < -max_speed || speed > max_speed || duration_ms < step_period_ms
        || duration_ms > max_step_ms) {
        shell_error(sh, "Usage: motor step <-%d..%d> <%d..%d ms>", max_speed, max_speed, step_period_ms,
            max_step_ms);
        return -EINVAL;
    }

    if (!device_is_ready(encoder)) {
        shell_error(sh, "Encoder not ready");
        return -ENODEV;
    }

    int32_t raw = 0;
    if (int ret = read_encoder(raw)) {
        shell_error(sh, "Encoder read failed (%d)", ret);
        return ret;
    }

    step_counts[0] = 0;
    size_t samples = 1;
    int32_t position = 0;
    bool fault_seen = false;

    int64_t start_ms = k_uptime_get();
    if (int ret = set_speed(static_cast<int>(speed))) {
        set_speed(0);
        return ret;
    }
    for (long t = step_period_ms; t <= duration_ms; t += step_period_ms) {
        k_sleep(K_TIMEOUT_ABS_MS(start_ms + t));
        int32_t now = 0;
        if (int ret = read_encoder(now)) {
            set_speed(0);
            shell_error(sh, "Encoder read failed (%d)", ret);
            return ret;
        }
        position += encoder_delta(raw, now);
        raw = now;
        step_counts[samples++] = position;
        fault_seen = fault_seen || gpio_pin_get_dt(&fault) == 1;
    }
    set_speed(0);

    shell_print(sh, "t_ms,count,counts_per_s");
    for (size_t i = 0; i < samples; i++) {
        int32_t per_s = i == 0 ? 0 : (step_counts[i] - step_counts[i - 1]) * (1000 / step_period_ms);
        shell_print(sh, "%d,%d,%d", static_cast<int>(i) * step_period_ms, static_cast<int>(step_counts[i]),
            static_cast<int>(per_s));
    }

    // Steady speed over the last quarter of the step, and the time to reach
    // 63 % of it (the time constant, for a first-order response).
    size_t last = samples - 1;
    size_t quarter = last / 4 > 0 ? last / 4 : 1;
    int32_t steady = (step_counts[last] - step_counts[last - quarter]) * (1000 / step_period_ms)
        / static_cast<int32_t>(quarter);
    long tau_ms = -1;
    for (size_t i = 1; steady != 0 && i <= last; i++) {
        int32_t per_s = (step_counts[i] - step_counts[i - 1]) * (1000 / step_period_ms);
        if ((steady >= 0 && per_s * 1000 >= steady * 632) || (steady < 0 && per_s * 1000 <= steady * 632)) {
            tau_ms = static_cast<long>(i) * step_period_ms;
            break;
        }
    }
    shell_print(sh, "steady: %d counts/s (%d rpm at the gearbox output), 63 %% at: %ld ms (-1: none)",
        static_cast<int>(steady), static_cast<int>(steady * 60 / counts_per_revolution), tau_ms);
    if (speed != 0 && steady != 0 && (speed > 0) != (steady > 0)) {
        shell_warn(sh, "The encoder counts against the motor direction");
    }
    if (fault_seen) {
        shell_warn(sh, "nFAULT was asserted during the step");
    }
    return 0;
}

int cmd_stop(const shell*, size_t, char**)
{
    return set_speed(0);
}

int cmd_status(const shell* sh, size_t, char**)
{
    shell_print(sh, "speed: %d, direction: %s, fault: %s", current_speed,
        current_speed >= 0 ? "forward" : "backward",
        gpio_pin_get_dt(&fault) ? "YES" : "no");
    return 0;
}

} // namespace

int motor_init()
{
    if (!pwm_is_ready_dt(&enable) || !gpio_is_ready_dt(&phase) || !gpio_is_ready_dt(&fault)) {
        return -ENODEV;
    }

    if (int ret = gpio_pin_configure_dt(&phase, GPIO_OUTPUT_ACTIVE)) {
        return ret;
    }
    if (int ret = gpio_pin_configure_dt(&fault, GPIO_INPUT)) {
        return ret;
    }
    if (int ret = gpio_pin_interrupt_configure_dt(&fault, GPIO_INT_EDGE_TO_ACTIVE)) {
        return ret;
    }
    gpio_init_callback(&fault_callback, on_fault, BIT(fault.pin));
    if (int ret = gpio_add_callback_dt(&fault, &fault_callback)) {
        return ret;
    }

    return set_speed(0);
}

SHELL_STATIC_SUBCMD_SET_CREATE(motor_cmds,
    SHELL_CMD_ARG(speed, NULL, "Set speed: motor speed <-255..255>", cmd_speed, 2, 0),
    SHELL_CMD_ARG(step, NULL,
        "Step response: motor step <-255..255> <10..5000 ms>; prints encoder samples every 10 ms",
        cmd_step, 3, 0),
    SHELL_CMD(stop, NULL, "Stop the motor", cmd_stop),
    SHELL_CMD(status, NULL, "Show speed and driver fault state", cmd_status),
    SHELL_SUBCMD_SET_END);
SHELL_CMD_REGISTER(motor, &motor_cmds, "Drive motor (DRV8874)", NULL);
```

## src/servo.cpp
```c
#include "bringup.h"

#include <zephyr/drivers/pwm.h>
#include <zephyr/shell/shell.h>

namespace {

#define SERVO_NODE DT_NODELABEL(steering_servo)

const pwm_dt_spec servo = PWM_DT_SPEC_GET(SERVO_NODE);
constexpr long min_pulse_us = DT_PROP(SERVO_NODE, min_pulse) / 1000;
constexpr long max_pulse_us = DT_PROP(SERVO_NODE, max_pulse) / 1000;

// Same angle range and meaning as v1's ISteeringServo::set_angle().
constexpr long max_angle = 180;

int cmd_angle(const shell* sh, size_t, char** argv)
{
    int err = 0;
    long angle = shell_strtol(argv[1], 10, &err);
    if (err || angle < 0 || angle > max_angle) {
        shell_error(sh, "Angle must be in [0, %ld]", max_angle);
        return -EINVAL;
    }

    long pulse_us = min_pulse_us + (max_pulse_us - min_pulse_us) * angle / max_angle;
    shell_print(sh, "angle %ld -> pulse %ld us", angle, pulse_us);
    return pwm_set_pulse_dt(&servo, PWM_USEC(pulse_us));
}

int cmd_pulse(const shell* sh, size_t, char** argv)
{
    int err = 0;
    long pulse_us = shell_strtol(argv[1], 10, &err);
    if (err || pulse_us < min_pulse_us || pulse_us > max_pulse_us) {
        shell_error(sh, "Pulse must be in [%ld, %ld] us", min_pulse_us, max_pulse_us);
        return -EINVAL;
    }
    return pwm_set_pulse_dt(&servo, PWM_USEC(pulse_us));
}

int cmd_off(const shell*, size_t, char**)
{
    return pwm_set_pulse_dt(&servo, 0);
}

} // namespace

int servo_init()
{
    // The servo stays unpowered (no pulses) until a command moves it.
    return pwm_is_ready_dt(&servo) ? 0 : -ENODEV;
}

SHELL_STATIC_SUBCMD_SET_CREATE(servo_cmds,
    SHELL_CMD_ARG(angle, NULL, "Move to an angle: servo angle <0..180>", cmd_angle, 2, 0),
    SHELL_CMD_ARG(pulse, NULL, "Set the raw pulse width: servo pulse <us>", cmd_pulse, 2, 0),
    SHELL_CMD(off, NULL, "Stop sending pulses (servo goes limp)", cmd_off),
    SHELL_SUBCMD_SET_END);
SHELL_CMD_REGISTER(servo, &servo_cmds, "Steering servo (HS-422)", NULL);
```

## src/ultrasonic.cpp
```c
// HY-SRF05 ranging: a 10 us TRIG pulse starts a measurement, and the ECHO
// pulse width is the round-trip time. The pulse edges are timestamped from
// the GPIO interrupt with the cycle counter.

#include "bringup.h"

#include <etl/array.h>
#include <zephyr/drivers/gpio.h>
#include <zephyr/kernel.h>
#include <zephyr/shell/shell.h>

namespace {

// Same conversion v1 used (NewPing's round-trip microseconds per cm).
constexpr int us_per_cm = 57;
// With nothing in range the HY-SRF05 still returns a ~30 ms echo pulse.
constexpr int out_of_range_us = 25000;
constexpr int echo_timeout_ms = 40;
// Let the previous ping's echoes die out before the next sensor fires.
constexpr int ping_gap_ms = 60;

struct Sonar {
    gpio_dt_spec trigger;
    gpio_dt_spec echo;
    gpio_callback callback;
    k_sem done;
    uint32_t rise_cycles;
    uint32_t width_cycles;
    bool rise_seen;
};

#define SONAR(node)                                                     \
    Sonar                                                               \
    {                                                                   \
        .trigger = GPIO_DT_SPEC_GET(DT_NODELABEL(node), trigger_gpios), \
        .echo = GPIO_DT_SPEC_GET(DT_NODELABEL(node), echo_gpios)        \
    }

etl::array sonars {
    SONAR(ultrasonic1),
    SONAR(ultrasonic2),
    SONAR(ultrasonic3),
    SONAR(ultrasonic4),
};

void on_echo_edge(const device*, gpio_callback* callback, gpio_port_pins_t)
{
    uint32_t now = k_cycle_get_32();
    Sonar* sonar = CONTAINER_OF(callback, Sonar, callback);

    if (gpio_pin_get_dt(&sonar->echo)) {
        sonar->rise_cycles = now;
        sonar->rise_seen = true;
    } else if (sonar->rise_seen) {
        sonar->width_cycles = now - sonar->rise_cycles;
        sonar->rise_seen = false;
        k_sem_give(&sonar->done);
    }
}

// Returns the echo pulse width in microseconds, or a negative errno.
int ping(Sonar& sonar)
{
    sonar.rise_seen = false;
    k_sem_reset(&sonar.done);

    gpio_pin_set_dt(&sonar.trigger, 1);
    k_busy_wait(10);
    gpio_pin_set_dt(&sonar.trigger, 0);

    if (k_sem_take(&sonar.done, K_MSEC(echo_timeout_ms))) {
        return -ETIMEDOUT;
    }
    return static_cast<int>(k_cyc_to_us_floor32(sonar.width_cycles));
}

void print_ping(const shell* sh, size_t index)
{
    int echo_us = ping(sonars[index]);
    if (echo_us < 0) {
        shell_print(sh, "sensor %u: no echo pulse (check wiring)", index + 1);
    } else if (echo_us >= out_of_range_us) {
        shell_print(sh, "sensor %u: out of range (%d us)", index + 1, echo_us);
    } else {
        shell_print(sh, "sensor %u: %d cm (%d us)", index + 1, echo_us / us_per_cm, echo_us);
    }
}

int cmd_sonar(const shell* sh, size_t argc, char** argv)
{
    if (argc == 1) {
        for (size_t i = 0; i < sonars.size(); i++) {
            if (i) {
                k_msleep(ping_gap_ms);
            }
            print_ping(sh, i);
        }
        return 0;
    }

    int err = 0;
    unsigned long number = shell_strtoul(argv[1], 10, &err);
    if (err || number < 1 || number > sonars.size()) {
        shell_error(sh, "Sensor must be 1..%u", sonars.size());
        return -EINVAL;
    }
    print_ping(sh, number - 1);
    return 0;
}

} // namespace

int ultrasonic_init()
{
    for (auto& sonar : sonars) {
        if (!gpio_is_ready_dt(&sonar.trigger) || !gpio_is_ready_dt(&sonar.echo)) {
            return -ENODEV;
        }

        k_sem_init(&sonar.done, 0, 1);
        if (int ret = gpio_pin_configure_dt(&sonar.trigger, GPIO_OUTPUT_INACTIVE)) {
            return ret;
        }
        if (int ret = gpio_pin_configure_dt(&sonar.echo, GPIO_INPUT)) {
            return ret;
        }
        if (int ret = gpio_pin_interrupt_configure_dt(&sonar.echo, GPIO_INT_EDGE_BOTH)) {
            return ret;
        }
        gpio_init_callback(&sonar.callback, on_echo_edge, BIT(sonar.echo.pin));
        if (int ret = gpio_add_callback_dt(&sonar.echo, &sonar.callback)) {
            return ret;
        }
    }
    return 0;
}

SHELL_CMD_ARG_REGISTER(sonar, NULL,
    "Measure distance: sonar [1..4] (all sensors if omitted)", cmd_sonar, 1, 1);
```
