## firmware/boards/shields/buttonled_shield/Kconfig.shield
```kconfig
config SHIELD_BUTTONLED_SHIELD
	def_bool $(shields_list_contains,buttonled_shield)
```

## firmware/boards/shields/motherboard_shield/Kconfig.shield
```kconfig
config SHIELD_MOTHERBOARD_SHIELD
	def_bool $(shields_list_contains,motherboard_shield)
```

## firmware/dts/bindings/wallckr,ph-en-motor.yaml
```yaml
description: |
  Brushed DC motor behind an H-bridge in phase/enable (PH/EN) mode, e.g. a
  DRV8874 with PMODE tied low: a PWM on EN sets the speed, PH the direction.

compatible: "wallckr,ph-en-motor"

include: base.yaml

properties:
  pwms:
    required: true
    type: phandle-array
    description: PWM specifier driving the EN input (speed).

  ph-gpios:
    required: true
    type: phandle-array
    description: GPIO driving the PH input. Active = forward.

  fault-gpios:
    type: phandle-array
    description: Driver fault output (nFAULT). Active = fault.
```

## firmware/tests/lib/testcase.yaml
```yaml
common:
  tags: lib
  platform_allow:
    - native_sim
  integration_platforms:
    - native_sim
tests:
  wallckr.lib: {}
```
